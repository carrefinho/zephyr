## CMakeLists.txt
```
# SPDX-License-Identifier: Apache-2.0

cmake_minimum_required(VERSION 3.20.0)

find_package(Zephyr REQUIRED HINTS $ENV{ZEPHYR_BASE})
project(bsim_test_prep_pipeline)

target_sources(app PRIVATE
  src/main.c
  src/lat_inject.c
  src/gatt_sink.c
  src/split.c
  src/dut.c
  src/host.c
)

# bsim test framework headers (bstests.h, bs_types.h, bs_tracing.h,
# time_machine.h) live in the BabbleSim components.
zephyr_include_directories(
  ${BSIM_COMPONENTS_PATH}/libUtilv1/src/
  ${BSIM_COMPONENTS_PATH}/libPhyComv1/src/
)
```

## prj.conf
```kconfig
CONFIG_BT=y
CONFIG_LOG=y

# LL_ASSERT(next) must actually fire and abort (with file:line) when the prepare
# pipeline overflows - that abort is the reproduction signal.
CONFIG_ASSERT=y
CONFIG_ASSERT_VERBOSE=y
CONFIG_BT_ASSERT=y

CONFIG_BT_CENTRAL=y
CONFIG_BT_PERIPHERAL=y
CONFIG_BT_GATT_CLIENT=y
CONFIG_BT_DEVICE_NAME="bsim_prep"

# The DUT holds two simultaneous links (host + split); 3 covers the shared binary.
CONFIG_BT_MAX_CONN=3

# Keep both links pinned at 7.5 ms: no peripheral-initiated ~5 s auto param
# update that would move the interval and de-correlate the two events.
CONFIG_BT_GAP_AUTO_UPDATE_CONN_PARAMS=n

# Saturate both links: large host + controller buffer pools so the continuous
# write-without-response loops keep many PDUs queued per connection event, so
# each 7.5 ms event runs long enough that the DUT's two events cannot avoid
# overlapping (which drives the LL_SW preempt/duplicate-prepare path).
# Host-side ACL/L2CAP TX queueing so each event packs many PDUs (long events;
# the controller's ACL Tx draws from these). Zephyr 4.1 rules: ACL_RX_COUNT is
# deprecated (use *_EXTRA), and BT_BUF_EVT_RX_COUNT must exceed ACL_TX_COUNT.
CONFIG_BT_BUF_ACL_TX_COUNT=12
CONFIG_BT_BUF_EVT_RX_COUNT=16
CONFIG_BT_BUF_ACL_RX_COUNT_EXTRA=12
CONFIG_BT_L2CAP_TX_BUF_COUNT=16
CONFIG_BT_CONN_TX_MAX=12
CONFIG_BT_CTLR_RX_BUFFERS=16

# Disable the EVENT_OVERHEAD_START "prepare latency" assert (the zmk#3331
# sibling family): under injected ISR latency it fires before the pipeline
# overflow on the 3.6-4.0-era controllers and masks the #3370 signal this
# repro exists to detect. Skipping it just lets the late prepare proceed.
CONFIG_BT_CTLR_ADVANCED_FEATURES=y
CONFIG_BT_CTLR_ASSERT_OVERHEAD_START=n
```

## overlay_accel.conf
```kconfig
# Accelerator overlay: shrink the prepare pipeline from 7 to 3 slots so the
# duplicate-prepare leak overflows in seconds instead of needing a long soak.
# Relies on the #ifndef guard added to ll_sw/lll.h. The bug is unchanged - only
# the headroom shrinks; the fix (93b951d + 0d1b4d2) still prevents overflow at
# this depth, so the A/B test stays valid. Confirm any overflow is the bug (not
# legitimate sizing) by checking the dumped pipeline for duplicate (same-param,
# different-ticks) entries, exactly as in the real coredump triage.
CONFIG_COMPILER_OPT="-DEVENT_PIPELINE_MAX=3"
```

## overlay_bisect.conf
```kconfig
# Bisect-only overlay: compile out the controller's crypto hal (CCM/AAR).
# The nrfx CCM event enum names changed inside the v3.7.0..v4.0.0 bisect
# range (NRF_CCM_EVENT_ENDCRYPT et al.), so older controller subtrees fail
# to build against the v4.0.0 workspace's hal_nordic - but only in code the
# repro never runs: the test never pairs or encrypts. Disabling LE
# encryption + privacy removes the drift-coupled code from the build
# without touching the scheduling paths under bisection.
CONFIG_BT_CTLR_LE_ENC=n
CONFIG_BT_CTLR_PRIVACY=n
```

## overlay_trace.conf
```kconfig
# Event-by-event prepare-pipeline trace (see strand_trace.h).
CONFIG_BT_CTLR_STRAND_TRACE=y

# Keep printk synchronous and in-order: with CONFIG_LOG=y printk is otherwise
# routed through the logging subsystem, which can reorder or drop output from
# ISR context - exactly the contexts being traced.
CONFIG_LOG_PRINTK=n
```

## prj_35.conf
```kconfig
CONFIG_BT=y
CONFIG_LOG=y

# LL_ASSERT(next) must actually fire and abort (with file:line) when the prepare
# pipeline overflows - that abort is the reproduction signal.
CONFIG_ASSERT=y
CONFIG_ASSERT_VERBOSE=y
CONFIG_BT_ASSERT=y

CONFIG_BT_CENTRAL=y
CONFIG_BT_PERIPHERAL=y
CONFIG_BT_GATT_CLIENT=y
CONFIG_BT_DEVICE_NAME="bsim_prep"

# The DUT holds two simultaneous links (host + split); 3 covers the shared binary.
CONFIG_BT_MAX_CONN=3

# Keep both links pinned at 7.5 ms: no peripheral-initiated ~5 s auto param
# update that would move the interval and de-correlate the two events.
CONFIG_BT_GAP_AUTO_UPDATE_CONN_PARAMS=n

# Saturate both links: large host + controller buffer pools so the continuous
# write-without-response loops keep many PDUs queued per connection event, so
# each 7.5 ms event runs long enough that the DUT's two events cannot avoid
# overlapping (which drives the LL_SW preempt/duplicate-prepare path).
# Zephyr 3.5 variant of prj.conf (the v3.5.0 negative-control build): 3.5 has
# no BT_BUF_ACL_RX_COUNT_EXTRA, so size BT_BUF_ACL_RX_COUNT directly.
CONFIG_BT_BUF_ACL_TX_COUNT=12
CONFIG_BT_BUF_EVT_RX_COUNT=16
CONFIG_BT_BUF_ACL_RX_COUNT=16
CONFIG_BT_L2CAP_TX_BUF_COUNT=16
# 3.5 constrains BT_CONN_TX_MAX to >= BT_L2CAP_TX_BUF_COUNT (range [16, 255])
CONFIG_BT_CONN_TX_MAX=16
CONFIG_BT_CTLR_RX_BUFFERS=16

# Disable the EVENT_OVERHEAD_START "prepare latency" assert (the zmk#3331
# sibling family): under injected ISR latency it fires before the pipeline
# overflow on the 3.6-4.0-era controllers and masks the #3370 signal this
# repro exists to detect. Skipping it just lets the late prepare proceed.
CONFIG_BT_CTLR_ADVANCED_FEATURES=y
CONFIG_BT_CTLR_ASSERT_OVERHEAD_START=n
```

## src/dut.c
```c
/*
 * Copyright (c) 2026 The ZMK Contributors
 * SPDX-License-Identifier: Apache-2.0
 *
 * Device 1 - the DUT, dual-role like a ZMK split central. It simultaneously:
 *   - advertises as DUT_NAME so `host` connects to it (DUT = PERIPHERAL link),
 *   - scans for SPLIT_NAME and connects to it (DUT = CENTRAL link),
 * both at 7.5 ms. Once the split link is up it blasts max-size writes to the
 * split (long central-link events); the host blasts the DUT (long peripheral-
 * link events). Two long 7.5 ms events on one radio cannot avoid overlapping,
 * forcing the LL_SW preempt/duplicate path every event.
 *
 * PASS = survived WAIT_TIME without the controller asserting. If the prepare
 * pipeline overflows, LL_ASSERT(next) (lll.c:891) aborts the binary instead -
 * that abort, with "ASSERTION FAIL [next]" in the log, IS the reproduction.
 */
#include <zephyr/kernel.h>
#include <string.h>
#include <stdio.h>
#include <errno.h>

#include "bs_types.h"
#include "bs_tracing.h"
#include "time_machine.h"
#include "bstests.h"

#include "lat_inject.h"

#include <zephyr/sys/printk.h>
#include <zephyr/bluetooth/bluetooth.h>
#include <zephyr/bluetooth/conn.h>
#include <zephyr/bluetooth/gap.h>

#include "prep_pipeline.h"
#include "gatt_sink.h"

#define WAIT_TIME 60 /* seconds */

extern enum bst_result_t bst_result;

#define FAIL(...)					\
	do {						\
		bst_result = Failed;			\
		bs_trace_error_time_line(__VA_ARGS__);	\
	} while (0)

#define PASS(...)					\
	do {						\
		bst_result = Passed;			\
		bs_trace_info_time(1, __VA_ARGS__);	\
	} while (0)

static struct bt_conn *split_conn;  /* DUT is CENTRAL on this link */
static struct bt_conn *host_conn;   /* DUT is PERIPHERAL on this link */
static volatile bool scanning;

/* CPU-latency injector lives in lat_inject.c so split/host can run the
 * identical injection as a single-link control (see lat_inject.h).
 */
static void test_args_parse(int argc, char *argv[])
{
	lat_inject_args_parse(argc, argv);
}

static const struct bt_data ad[] = {
	BT_DATA_BYTES(BT_DATA_FLAGS, (BT_LE_AD_GENERAL | BT_LE_AD_NO_BREDR)),
	BT_DATA(BT_DATA_NAME_COMPLETE, DUT_NAME, sizeof(DUT_NAME) - 1),
};

/* ---- find the split by advertised name ---------------------------------- */

struct name_match {
	const char *want;
	bool found;
};

static bool ad_name_cb(struct bt_data *data, void *user_data)
{
	struct name_match *m = user_data;

	if (data->type == BT_DATA_NAME_COMPLETE &&
	    data->data_len == strlen(m->want) &&
	    memcmp(data->data, m->want, data->data_len) == 0) {
		m->found = true;
		return false; /* stop parsing */
	}
	return true;
}

static void device_found(const bt_addr_le_t *addr, int8_t rssi, uint8_t type,
			 struct net_buf_simple *adv)
{
	struct name_match m = { .want = SPLIT_NAME, .found = false };
	struct bt_le_conn_param *param;
	int err;

	if (split_conn || (type != BT_GAP_ADV_TYPE_ADV_IND)) {
		return;
	}

	bt_data_parse(adv, ad_name_cb, &m);
	if (!m.found) {
		return;
	}

	if (bt_le_scan_stop() == 0) {
		scanning = false;
	}

	/* DUT is CENTRAL on the split link: 7.5 ms, latency 30 (matches the dump). */
	param = BT_LE_CONN_PARAM(SPLIT_INTERVAL_UNITS, SPLIT_INTERVAL_UNITS,
				 CONN_LATENCY, CONN_TIMEOUT_UNITS);
	err = bt_conn_le_create(addr, BT_CONN_LE_CREATE_CONN, param, &split_conn);
	if (err) {
		FAIL("DUT: create split connection failed (err %d)\n", err);
	}
}

static void connected(struct bt_conn *conn, uint8_t err)
{
	struct bt_conn_info info;

	if (err) {
		printk("DUT connect failed (err 0x%02x)\n", err);
		return;
	}
	if (bt_conn_get_info(conn, &info) != 0) {
		return;
	}

	if (info.role == BT_CONN_ROLE_CENTRAL) {
		printk("DUT connected to split (central link)\n");
	} else {
		host_conn = bt_conn_ref(conn);
		printk("DUT connected to host (peripheral link)\n");
	}
}

static void disconnected(struct bt_conn *conn, uint8_t reason)
{
	printk("DUT disconnected (reason 0x%02x)\n", reason);
	if (conn == split_conn) {
		bt_conn_unref(split_conn);
		split_conn = NULL;
	} else if (conn == host_conn) {
		bt_conn_unref(host_conn);
		host_conn = NULL;
	}
}

static struct bt_conn_cb conn_callbacks = {
	.connected = connected,
	.disconnected = disconnected,
};

static void dut_main(void)
{
	uint16_t split_sink;
	int err;

	bt_conn_cb_register(&conn_callbacks);

	err = bt_enable(NULL);
	if (err) {
		FAIL("DUT bt_enable failed (err %d)\n", err);
		return;
	}

	err = bt_le_adv_start(BT_LE_ADV_CONN_FAST_1, ad, ARRAY_SIZE(ad), NULL, 0);
	if (err) {
		FAIL("DUT advertising failed (err %d)\n", err);
		return;
	}
	printk("DUT advertising as %s\n", DUT_NAME);

	err = bt_le_scan_start(BT_LE_SCAN_PASSIVE, device_found);
	if (err) {
		FAIL("DUT scan start failed (err %d)\n", err);
		return;
	}
	scanning = true;
	printk("DUT scanning for %s\n", SPLIT_NAME);

	/* Wait for the central (split) link, then discover its sink. */
	while (!split_conn) {
		k_sleep(K_MSEC(20));
		if (bst_result == Failed) {
			return;
		}
	}
	k_sleep(K_MSEC(SETTLE_DELAY_MS));

	if (sink_discover(split_conn, &split_sink) != 0) {
		FAIL("DUT could not discover split sink\n");
		return;
	}

	printk("DUT blasting split link; host drives the peripheral link\n");

	/* Both links are up and discovered: start the CPU-latency injector so
	 * connection setup runs clean and only steady-state traffic sees the
	 * delayed ISRs.
	 */
	lat_inject_start("DUT");

	/* Saturate the central link forever. The host saturates the peripheral
	 * link from its side. Both DUT events run long and overlap at 7.5 ms.
	 */
	while (split_conn) {
		sink_blast_one(split_conn, split_sink);
	}
}

static void dut_init(void)
{
	bst_ticker_set_next_tick_absolute(WAIT_TIME * 1e6);
	bst_result = In_progress;
}

static void dut_tick(bs_time_t HW_device_time)
{
	/* Reached the deadline without the controller asserting: the prepare
	 * pipeline did NOT overflow this run. (On the buggy controller, try more
	 * seeds / the EVENT_PIPELINE_MAX accelerator; on the fixed controller this
	 * is the expected PASS.)
	 */
	if (bst_result == In_progress) {
		PASS("DUT survived %i s with no prepare-pipeline overflow\n", WAIT_TIME);
	}
}

static const struct bst_test_instance dut_tests[] = {
	{
		.test_id = "dut",
		.test_descr = "Dual-role DUT (peripheral to host + central to split); "
			      "drives both 7.5 ms links to overlap.",
		.test_args_f = test_args_parse,
		.test_pre_init_f = dut_init,
		.test_tick_f = dut_tick,
		.test_main_f = dut_main,
	},
	BSTEST_END_MARKER,
};

struct bst_test_list *test_dut_install(struct bst_test_list *tests)
{
	return bst_add_tests(tests, dut_tests);
}
```

## src/gatt_sink.c
```c
/*
 * Copyright (c) 2026 The ZMK Contributors
 * SPDX-License-Identifier: Apache-2.0
 */
#include <zephyr/kernel.h>
#include <errno.h>
#include <zephyr/sys/printk.h>

#include <zephyr/bluetooth/bluetooth.h>
#include <zephyr/bluetooth/conn.h>
#include <zephyr/bluetooth/gatt.h>
#include <zephyr/bluetooth/uuid.h>

#include "prep_pipeline.h"
#include "gatt_sink.h"

/* ---- Server side: every device exposes the sink characteristic ---------- */

static volatile uint32_t sink_rx_count;

static ssize_t sink_write_cb(struct bt_conn *conn, const struct bt_gatt_attr *attr,
			     const void *buf, uint16_t len, uint16_t offset, uint8_t flags)
{
	ARG_UNUSED(conn);
	ARG_UNUSED(attr);
	ARG_UNUSED(buf);
	ARG_UNUSED(offset);
	ARG_UNUSED(flags);
	sink_rx_count++;
	return len;
}

BT_GATT_SERVICE_DEFINE(sink_svc,
	BT_GATT_PRIMARY_SERVICE(BT_UUID_DECLARE_128(SINK_SVC_UUID)),
	BT_GATT_CHARACTERISTIC(BT_UUID_DECLARE_128(SINK_CHR_UUID),
			       BT_GATT_CHRC_WRITE_WITHOUT_RESP, BT_GATT_PERM_WRITE,
			       NULL, sink_write_cb, NULL));

/* ---- Client side: discover the value handle, then blast max writes ------ */

static struct bt_uuid_128 sink_chr_uuid = BT_UUID_INIT_128(SINK_CHR_UUID);
static struct bt_gatt_discover_params disc_params;
static uint16_t disc_handle;
static K_SEM_DEFINE(disc_done, 0, 1);

static uint8_t disc_cb(struct bt_conn *conn, const struct bt_gatt_attr *attr,
		       struct bt_gatt_discover_params *params)
{
	if (attr) {
		disc_handle = bt_gatt_attr_value_handle(attr);
	}
	k_sem_give(&disc_done);
	return BT_GATT_ITER_STOP;
}

int sink_discover(struct bt_conn *conn, uint16_t *handle)
{
	int err;

	disc_handle = 0U;
	k_sem_reset(&disc_done);

	disc_params.uuid = &sink_chr_uuid.uuid;
	disc_params.func = disc_cb;
	disc_params.start_handle = 0x0001U;
	disc_params.end_handle = 0xffffU;
	disc_params.type = BT_GATT_DISCOVER_CHARACTERISTIC;

	err = bt_gatt_discover(conn, &disc_params);
	if (err) {
		printk("sink discover start failed (err %d)\n", err);
		return err;
	}

	if (k_sem_take(&disc_done, K_SECONDS(5)) != 0 || disc_handle == 0U) {
		printk("sink discover did not complete\n");
		return -ETIMEDOUT;
	}

	*handle = disc_handle;
	printk("sink characteristic value handle = 0x%04x\n", disc_handle);
	return 0;
}

void sink_blast_one(struct bt_conn *conn, uint16_t handle)
{
	static uint8_t payload[SINK_WRITE_LEN];
	int err;

	/* Retry on tx-buffer exhaustion so events stay full; bail if the conn
	 * goes away (write returns -ENOTCONN).
	 */
	do {
		err = bt_gatt_write_without_response(conn, handle, payload,
						     sizeof(payload), false);
		if (err == -ENOMEM || err == -ENOBUFS || err == -EAGAIN) {
			k_sleep(K_MSEC(1));
			continue;
		}
		break;
	} while (true);

	if (err && err != -ENOTCONN) {
		/* Unexpected; don't spam, just yield. */
		k_sleep(K_MSEC(1));
	}
}
```

## src/host.c
```c
/*
 * Copyright (c) 2026 The ZMK Contributors
 * SPDX-License-Identifier: Apache-2.0
 *
 * Device 2 - the "host". A plain central that connects to the DUT at 7.5 ms and
 * blasts max-size writes at it, saturating the DUT's PERIPHERAL link (stands in
 * for the computer streaming HID to a ZMK central). Mirrors split's role on the
 * other side of the DUT.
 */
#include <zephyr/kernel.h>
#include <string.h>
#include <errno.h>

#include "bs_types.h"
#include "bs_tracing.h"
#include "time_machine.h"
#include "bstests.h"

#include "lat_inject.h"

#include <zephyr/sys/printk.h>
#include <zephyr/bluetooth/bluetooth.h>
#include <zephyr/bluetooth/conn.h>
#include <zephyr/bluetooth/gap.h>

#include "prep_pipeline.h"
#include "gatt_sink.h"

#define WAIT_TIME 60 /* seconds */

extern enum bst_result_t bst_result;

#define FAIL(...)					\
	do {						\
		bst_result = Failed;			\
		bs_trace_error_time_line(__VA_ARGS__);	\
	} while (0)

#define PASS(...)					\
	do {						\
		bst_result = Passed;			\
		bs_trace_info_time(1, __VA_ARGS__);	\
	} while (0)

static struct bt_conn *dut_conn;

struct name_match {
	const char *want;
	bool found;
};

static bool ad_name_cb(struct bt_data *data, void *user_data)
{
	struct name_match *m = user_data;

	if (data->type == BT_DATA_NAME_COMPLETE &&
	    data->data_len == strlen(m->want) &&
	    memcmp(data->data, m->want, data->data_len) == 0) {
		m->found = true;
		return false;
	}
	return true;
}

static void device_found(const bt_addr_le_t *addr, int8_t rssi, uint8_t type,
			 struct net_buf_simple *adv)
{
	struct name_match m = { .want = DUT_NAME, .found = false };
	struct bt_le_conn_param *param;
	int err;

	if (dut_conn || (type != BT_GAP_ADV_TYPE_ADV_IND)) {
		return;
	}

	bt_data_parse(adv, ad_name_cb, &m);
	if (!m.found) {
		return;
	}

	(void)bt_le_scan_stop();

	/* Host is CENTRAL on the host link: 15 ms, latency 30 (matches the dump).
	 * The 15 ms vs the split's 7.5 ms + per-device xo_drift makes the DUT's two
	 * events sweep into collision. */
	param = BT_LE_CONN_PARAM(HOST_INTERVAL_UNITS, HOST_INTERVAL_UNITS,
				 CONN_LATENCY, CONN_TIMEOUT_UNITS);
	err = bt_conn_le_create(addr, BT_CONN_LE_CREATE_CONN, param, &dut_conn);
	if (err) {
		FAIL("Host: create DUT connection failed (err %d)\n", err);
	}
}

static void connected(struct bt_conn *conn, uint8_t err)
{
	if (err) {
		FAIL("Host failed to connect (err 0x%02x)\n", err);
		return;
	}
	printk("Host connected to DUT (central link)\n");
}

static void disconnected(struct bt_conn *conn, uint8_t reason)
{
	printk("Host disconnected (reason 0x%02x)\n", reason);
	if (conn == dut_conn) {
		bt_conn_unref(dut_conn);
		dut_conn = NULL;
	}
}

static struct bt_conn_cb conn_callbacks = {
	.connected = connected,
	.disconnected = disconnected,
};

static void host_main(void)
{
	uint16_t dut_sink;
	int err;

	bt_conn_cb_register(&conn_callbacks);

	err = bt_enable(NULL);
	if (err) {
		FAIL("Host bt_enable failed (err %d)\n", err);
		return;
	}

	err = bt_le_scan_start(BT_LE_SCAN_PASSIVE, device_found);
	if (err) {
		FAIL("Host scan start failed (err %d)\n", err);
		return;
	}
	printk("Host scanning for %s\n", DUT_NAME);

	while (!dut_conn) {
		k_sleep(K_MSEC(20));
		if (bst_result == Failed) {
			return;
		}
	}
	k_sleep(K_MSEC(SETTLE_DELAY_MS));

	if (sink_discover(dut_conn, &dut_sink) != 0) {
		FAIL("Host could not discover DUT sink\n");
		return;
	}

	/* Single-link CONTROL: host is central on exactly one connection. */
	lat_inject_start("HOST");

	printk("Host blasting DUT peripheral link\n");
	while (dut_conn) {
		sink_blast_one(dut_conn, dut_sink);
	}
}

static void host_init(void)
{
	bst_ticker_set_next_tick_absolute(WAIT_TIME * 1e6);
	bst_result = In_progress;
}

static void host_tick(bs_time_t HW_device_time)
{
	if (bst_result == In_progress) {
		PASS("Host completed run\n");
	}
}

static const struct bst_test_instance host_tests[] = {
	{
		.test_id = "host",
		.test_args_f = lat_inject_args_parse,
		.test_descr = "Host central: connects to the DUT and saturates its "
			      "peripheral link.",
		.test_pre_init_f = host_init,
		.test_tick_f = host_tick,
		.test_main_f = host_main,
	},
	BSTEST_END_MARKER,
};

struct bst_test_list *test_host_install(struct bst_test_list *tests)
{
	return bst_add_tests(tests, host_tests);
}
```

## src/lat_inject.c
```c
/*
 * Copyright (c) 2026 The ZMK Contributors
 * SPDX-License-Identifier: Apache-2.0
 *
 * CPU-latency injector, shared by all three devices in this test.
 *
 * bsim executes all CPU work in ZERO simulated time, so the ULL/ISR latency a
 * real ZMK central experiences (kernel spinlock critical sections, SPI display
 * + kscan ISRs, and internal-flash writes/erases that stall the whole CPU for
 * 41 us .. 85 ms on nRF52) never occurs, and the controller's prepares are
 * always enqueued, preempted, and dequeued exactly on time. The June 2026
 * sweeps varied only link GEOMETRY (intervals/drift/phase) and never
 * overflowed.
 *
 * This thread periodically masks interrupts and burns simulated time, delaying
 * the radio/ticker ISRs the way real critical sections and flash stalls do:
 *   lat_burst  = busy-wait length in us (0 = injector disabled)
 *   lat_period = sleep between bursts in us
 * Passed per-run via bsim test args: -argstest lat_burst=N lat_period=N
 *
 * Injection mode (-argstest lat_isr=):
 *   0 - thread + irq_lock() + k_busy_wait(). Faithful, but SIGSEGVs the
 *       3.5-3.7-era simulator: an IRQ latched during the locked burst is
 *       dispatched at irq_unlock() through an unpopulated irq_vector_table
 *       entry (jump to a garbage address in posix_irq_handler).
 *   1 - k_busy_wait() inside a k_timer ISR. Crash-free but INERT: the
 *       simulator advances time with nested dispatch during the busy-wait,
 *       so the radio is serviced on schedule and nothing is delayed
 *       (verified: 4.0/4.1 stop reproducing under this mode).
 *   2 - (default) thread that irq_disable()s only the controller's own
 *       IRQs (RADIO, TIMER0, RTC0, SWI4, SWI5) around the busy-wait. Their
 *       vectors are populated, so re-enabling dispatches pending IRQs
 *       through valid entries on every tree era, while the radio genuinely
 *       waits out the burst. Only currently-enabled IRQs are touched.
 */
#include <zephyr/kernel.h>
#include <stdio.h>
#include <zephyr/sys/printk.h>
#include <zephyr/sys/util.h>
#include <zephyr/irq.h>

#include "lat_inject.h"

static uint32_t lat_burst_us;
static uint32_t lat_period_us = 3300;
static uint32_t lat_isr = 2;

/* nRF52 controller IRQ numbers: RADIO=1, TIMER0=8, RTC0=11, SWI4=20, SWI5=21 */
static const unsigned int lat_masked_irqs[] = {1, 8, 11, 20, 21};

/* Generous stack: on the 3.5-3.7-era kernels a 1024 B stack for this thread
 * silently overflowed on the POSIX arch (no MPU) - corrupted ACL traffic then
 * a native SIGSEGV ~30 ms after arming, which masqueraded as a passing rung
 * until the verdict logic required end-of-sim evidence.
 */
static K_THREAD_STACK_DEFINE(lat_stack, 4096);
static struct k_thread lat_thread;

static void lat_burst_timer_cb(struct k_timer *timer)
{
	k_busy_wait(lat_burst_us);
}

static K_TIMER_DEFINE(lat_burst_timer, lat_burst_timer_cb, NULL);

static void lat_injector(void *p1, void *p2, void *p3)
{
	if (lat_isr == 1) {
		k_timer_start(&lat_burst_timer, K_USEC(lat_period_us),
			      K_USEC(lat_period_us));
		return;
	}

	while (true) {
		k_usleep(lat_period_us);

		if (lat_isr == 2) {
			uint32_t was = 0;

			for (int i = 0; i < ARRAY_SIZE(lat_masked_irqs); i++) {
				if (arch_irq_is_enabled(lat_masked_irqs[i])) {
					was |= BIT(i);
					irq_disable(lat_masked_irqs[i]);
				}
			}

			printk("STRAND inj mask on\n");
			k_busy_wait(lat_burst_us);

			for (int i = 0; i < ARRAY_SIZE(lat_masked_irqs); i++) {
				if (was & BIT(i)) {
					irq_enable(lat_masked_irqs[i]);
				}
			}
			printk("STRAND inj mask off\n");
		} else {
			unsigned int key = irq_lock();

			k_busy_wait(lat_burst_us);
			irq_unlock(key);
		}
	}
}

void lat_inject_args_parse(int argc, char *argv[])
{
	for (int i = 0; i < argc; i++) {
		if (sscanf(argv[i], "lat_burst=%u", &lat_burst_us) == 1) {
			continue;
		}
		if (sscanf(argv[i], "lat_isr=%u", &lat_isr) == 1) {
			continue;
		}
		if (sscanf(argv[i], "lat_period=%u", &lat_period_us) == 1) {
			continue;
		}
	}
}

void lat_inject_start(const char *who)
{
	if (lat_burst_us == 0) {
		return;
	}

	k_thread_create(&lat_thread, lat_stack, K_THREAD_STACK_SIZEOF(lat_stack),
			lat_injector, NULL, NULL, NULL,
			K_PRIO_PREEMPT(0), 0, K_NO_WAIT);
	printk("%s latency injector (mode %u): %u us burst every %u us\n",
	       who, lat_isr, lat_burst_us, lat_period_us);
}
```

## src/lat_inject.h
```c
/*
 * Copyright 2026 The ZMK Contributors
 * SPDX-License-Identifier: Apache-2.0
 *
 * Shared CPU-latency injector. Extracted from dut.c so the single-link
 * devices (split, host) can run the identical injection, which is the
 * control for "does the prepare-pipeline overflow require a dual-role
 * device?".
 */
#ifndef PREP_PIPELINE_LAT_INJECT_H_
#define PREP_PIPELINE_LAT_INJECT_H_

/* Parse -argstest lat_burst= / lat_period= / lat_isr= */
void lat_inject_args_parse(int argc, char *argv[]);

/* Start the injector thread if lat_burst > 0. Call once, after the device's
 * links are up, so connection setup runs clean.  `who` is used for logging.
 */
void lat_inject_start(const char *who);

#endif /* PREP_PIPELINE_LAT_INJECT_H_ */
```

## src/prep_pipeline.h
```c
/*
 * Copyright (c) 2026 The ZMK Contributors
 *
 * SPDX-License-Identifier: Apache-2.0
 *
 * Shared parameters for the prepare-pipeline-overflow repro.
 *
 * Topology (mirrors a ZMK split CENTRAL):
 *
 *   host (central) --7.5ms--> DUT (peripheral + central) --7.5ms--> split (peripheral)
 *
 * The DUT holds TWO simultaneous links on one radio - peripheral to `host`,
 * central to `split` - exactly like a ZMK central (BLE peripheral to the
 * computer, BLE central to its split half). Both links run at 7.5 ms with
 * max-size write-without-response traffic so each connection event is long
 * enough that the two events cannot coexist in one 7.5 ms interval without
 * overlapping. That forces the LL_SW preempt/duplicate path every event, which
 * (pre-fix) mis-enqueues duplicate prepares of the same conn into the 7-slot
 * `prep` MFIFO until ull_prepare_enqueue() returns NULL and LL_ASSERT(next)
 * (lll.c:891) trips: a K_ERR_KERNEL_OOPS, the crash seen in zmkfirmware/zmk#3370.
 */
#ifndef PREP_PIPELINE_H_
#define PREP_PIPELINE_H_

/* Zephyr 3.5 (the v3.5.0 control build) predates BT_LE_ADV_CONN_FAST_1. All
 * users include <zephyr/bluetooth/bluetooth.h> before this header.
 */
#ifndef BT_LE_ADV_CONN_FAST_1
#define BT_LE_ADV_CONN_FAST_1 BT_LE_ADV_CONN
#endif

/* Real parameters read straight out of the zmk#3370 coredump (lll_conn structs):
 *   host link  (DUT=peripheral, to the computer): 15 ms, latency 30
 *   split link (DUT=central, to the peripheral):  7.5 ms, latency 30
 * Different intervals (2:1) is how it actually runs. The collision DRIVER is the
 * ~+-40 ppm crystal-drift difference between the keyboard's clock (which drives
 * the split link, DUT=central) and the host's clock (which drives the host link,
 * DUT=peripheral): over ~70 s the two anchors sweep into periodic collision, the
 * controller defers events, and the buggy dequeue leaks duplicate prepares.
 * bsim has ZERO drift by default (xo_drift=0), so the launch script must set a
 * per-device -xo_drift to reproduce the sweep (exaggerated to collide fast).
 * Auto param update is disabled (prj.conf) so the intervals stay put.
 */
/* The real intervals (split 6, host 12 or 9) are harmonic/semi-harmonic, so on
 * silicon they only sweep into collision via crystal drift. In bsim all clocks
 * are ideal (xo_drift=0), so harmonic intervals never collide, and forcing the
 * sweep with a large xo_drift instead breaks the link (the peripheral can't
 * track the drifted anchor -> supervision timeout). Instead pick COPRIME
 * intervals: 6 and 7 share no factor, so the host event beats through every
 * phase relative to the split events (~every 42 units = 52.5 ms) with ZERO
 * drift and rock-stable links -- reproducing the same different-rate-collision
 * mechanism the dumps show, deterministically. Latency 0: under continuous
 * traffic the real links don't skip either (latency_event=0 in the dump). */
#define SPLIT_INTERVAL_UNITS 6U   /* 7.5 ms   (DUT is central here) */
#define HOST_INTERVAL_UNITS  7U   /* 8.75 ms  (DUT is peripheral here; coprime to 6) */
#define CONN_LATENCY         0U
#define CONN_TIMEOUT_UNITS   400U /* 4 s (10 ms units) */

/* Advertised names, so each scanner connects to the right peer. */
#define DUT_NAME   "bsim_dut"
#define SPLIT_NAME "bsim_split"

/* A single write-without-response sink characteristic. Every device exposes it
 * (server side); clients (host->DUT, DUT->split) discover its value handle and
 * hammer it with max-size writes to lengthen connection events.
 */
#define SINK_SVC_UUID \
	BT_UUID_128_ENCODE(0x9a7c0001, 0xbeef, 0x4d0e, 0x9e1a, 0xc0ffee0f100d)
#define SINK_CHR_UUID \
	BT_UUID_128_ENCODE(0x9a7c0002, 0xbeef, 0x4d0e, 0x9e1a, 0xc0ffee0f100d)

/* Write-without-response payload. Kept at the default ATT MTU max (23 - 3 = 20)
 * so no MTU exchange is needed; the saturating client loop instead queues MANY
 * such writes per event (backed by the large tx/rx buffer pools in prj.conf), so
 * each 7.5 ms event packs enough PDUs to run long and overlap the other link. */
#define SINK_WRITE_LEN 20

#define SETTLE_DELAY_MS 500

#endif /* PREP_PIPELINE_H_ */
```

## src/split.c
```c
/*
 * Copyright (c) 2026 The ZMK Contributors
 * SPDX-License-Identifier: Apache-2.0
 *
 * Device 0 - the "split peripheral". Advertises connectably as SPLIT_NAME,
 * accepts the DUT's central connection, and idles as a write sink (the global
 * sink service in gatt_sink.c absorbs the DUT's max-size writes, lengthening the
 * split-link events). Never disconnects.
 */
#include <zephyr/kernel.h>
#include <string.h>

#include "bs_types.h"
#include "bs_tracing.h"
#include "time_machine.h"
#include "bstests.h"

#include "lat_inject.h"

#include <zephyr/sys/printk.h>
#include <zephyr/bluetooth/bluetooth.h>
#include <zephyr/bluetooth/conn.h>

#include "prep_pipeline.h"

#define WAIT_TIME 25 /* seconds; must stay BELOW the sim length or the tick never fires */

extern enum bst_result_t bst_result;

#define FAIL(...)					\
	do {						\
		bst_result = Failed;			\
		bs_trace_error_time_line(__VA_ARGS__);	\
	} while (0)

#define PASS(...)					\
	do {						\
		bst_result = Passed;			\
		bs_trace_info_time(1, __VA_ARGS__);	\
	} while (0)

static volatile bool connected_flag;
static unsigned int split_uptime_s;

static const struct bt_data ad[] = {
	BT_DATA_BYTES(BT_DATA_FLAGS, (BT_LE_AD_GENERAL | BT_LE_AD_NO_BREDR)),
	BT_DATA(BT_DATA_NAME_COMPLETE, SPLIT_NAME, sizeof(SPLIT_NAME) - 1),
};

static void connected(struct bt_conn *conn, uint8_t err)
{
	if (err) {
		FAIL("Split failed to connect (err 0x%02x)\n", err);
		return;
	}
	connected_flag = true;
	printk("Split connected (central=DUT)\n");
	PASS("Split connected; serving as write sink\n");
}

static void disconnected(struct bt_conn *conn, uint8_t reason)
{
	printk("Split disconnected (reason 0x%02x)\n", reason);
	connected_flag = false;
}

static struct bt_conn_cb conn_callbacks = {
	.connected = connected,
	.disconnected = disconnected,
};

static void split_main(void)
{
	int err;

	bt_conn_cb_register(&conn_callbacks);

	err = bt_enable(NULL);
	if (err) {
		FAIL("Split bt_enable failed (err %d)\n", err);
		return;
	}

	err = bt_le_adv_start(BT_LE_ADV_CONN_FAST_1, ad, ARRAY_SIZE(ad), NULL, 0);
	if (err) {
		FAIL("Split advertising failed (err %d)\n", err);
		return;
	}
	printk("Split advertising as %s\n", SPLIT_NAME);

	/* Single-link CONTROL: wait for the DUT's link, then run the identical
	 * injector. Split is peripheral on exactly one connection, so if the
	 * overflow needs a dual-role device this can never reproduce.
	 */
	while (!connected_flag) {
		k_sleep(K_MSEC(20));
	}
	k_sleep(K_MSEC(SETTLE_DELAY_MS));
	lat_inject_start("SPLIT");

	/* Idle; the sink service absorbs writes. Survive the whole sim.
	 *
	 * Heartbeat every second: this device never receives the framework's
	 * end-of-sim marker in its log, so "survived" has to be positively
	 * evidenced by its own output. Without this the verdict logic can only
	 * ever return HARNESS_DEATH for a split-targeted run, regardless of
	 * what the controller actually did.
	 */
	while (true) {
		k_sleep(K_SECONDS(1));
		printk("SPLIT alive t=%u s conn=%d\n", ++split_uptime_s,
		       connected_flag ? 1 : 0);
	}
}

static void split_init(void)
{
	bst_ticker_set_next_tick_absolute(WAIT_TIME * 1e6);
	bst_result = In_progress;
}

static void split_tick(bs_time_t HW_device_time)
{
	/* Surviving to the deadline still connected is success for this peer. */
	if (bst_result != Passed) {
		FAIL("split: not connected after %i seconds\n", WAIT_TIME);
	}
}

static const struct bst_test_instance split_tests[] = {
	{
		.test_id = "split",
		.test_args_f = lat_inject_args_parse,
		.test_descr = "Split peripheral: connectable write sink for the DUT.",
		.test_pre_init_f = split_init,
		.test_tick_f = split_tick,
		.test_main_f = split_main,
	},
	BSTEST_END_MARKER,
};

struct bst_test_list *test_split_install(struct bst_test_list *tests)
{
	return bst_add_tests(tests, split_tests);
}
```
