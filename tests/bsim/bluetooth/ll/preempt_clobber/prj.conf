## CMakeLists.txt
```
# SPDX-License-Identifier: Apache-2.0

cmake_minimum_required(VERSION 3.20.0)

find_package(Zephyr REQUIRED HINTS $ENV{ZEPHYR_BASE})
project(bsim_test_preempt_clobber)

target_sources(app PRIVATE
  src/main.c
  src/gatt_sink.c
  src/split.c
  src/dut.c
  src/host.c
)

# bsim test framework headers (bstests.h, bs_types.h, bs_tracing.h,
# time_machine.h) live in the BabbleSim components.
zephyr_include_directories(
  ${BSIM_COMPONENTS_PATH}/libUtilv1/src/
  ${BSIM_COMPONENTS_PATH}/libPhyComv1/src/
)

# Compile the LLL test hooks (lll.c, hal/debug.h) into the controller.
zephyr_compile_definitions(LLL_TEST_PREEMPT_HOOKS)
```

## prj.conf
```kconfig
CONFIG_BT=y
CONFIG_LOG=y

# Controller asserts must fire and abort with file:line.
CONFIG_ASSERT=y
CONFIG_ASSERT_VERBOSE=y
CONFIG_BT_ASSERT=y

CONFIG_BT_CENTRAL=y
CONFIG_BT_PERIPHERAL=y
CONFIG_BT_GATT_CLIENT=y
CONFIG_BT_DEVICE_NAME="bsim_clobber"

# The DUT holds two simultaneous links (host + split); 3 covers the shared binary.
CONFIG_BT_MAX_CONN=3

# Keep both links pinned at 7.5 ms: no peripheral-initiated ~5 s auto param
# update that would move the interval and de-correlate the two events.
CONFIG_BT_GAP_AUTO_UPDATE_CONN_PARAMS=n

# Saturate both links: large host + controller buffer pools so the continuous
# write-without-response loops keep many PDUs queued per connection event, so
# each 7.5 ms event runs long enough that the DUT's two events cannot avoid
# overlapping (which drives the LL_SW preempt/duplicate-prepare path).
# Host-side ACL/L2CAP TX queueing so each event packs many PDUs (long events;
# the controller's ACL Tx draws from these). Zephyr 4.1 rules: ACL_RX_COUNT is
# deprecated (use *_EXTRA), and BT_BUF_EVT_RX_COUNT must exceed ACL_TX_COUNT.
CONFIG_BT_BUF_ACL_TX_COUNT=12
CONFIG_BT_BUF_EVT_RX_COUNT=16
CONFIG_BT_BUF_ACL_RX_COUNT_EXTRA=12
CONFIG_BT_L2CAP_TX_BUF_COUNT=16
CONFIG_BT_CONN_TX_MAX=12
CONFIG_BT_CTLR_RX_BUFFERS=16

# Count build: late prepares are counted by the LLL test hook instead of
# asserting (overlay_assert.conf restores the default assert).
CONFIG_BT_CTLR_ADVANCED_FEATURES=y
CONFIG_BT_CTLR_ASSERT_OVERHEAD_START=n
```

## overlay_assert.conf
```kconfig
# Default controller behavior: a late prepare trips LL_ASSERT_OVERHEAD.
CONFIG_BT_CTLR_ASSERT_OVERHEAD_START=y
```

## src/main.c
```c
/*
 * Copyright (c) 2026 The ZMK Contributors
 * SPDX-License-Identifier: Apache-2.0
 */
#include "bstests.h"

extern struct bst_test_list *test_split_install(struct bst_test_list *tests);
extern struct bst_test_list *test_dut_install(struct bst_test_list *tests);
extern struct bst_test_list *test_host_install(struct bst_test_list *tests);

bst_test_install_t test_installers[] = {
	test_split_install,
	test_dut_install,
	test_host_install,
	NULL
};

int main(void)
{
	bst_main();
	return 0;
}
```

## src/dut.c
```c
/*
 * Copyright (c) 2026 The ZMK Contributors
 * SPDX-License-Identifier: Apache-2.0
 *
 * Device 1 - the DUT, dual-role like a ZMK split central: peripheral to
 * `host`, central to `split`. The host drops and re-makes its link every
 * cycle_ms; on each host disconnect, with clobber=1, the DUT zeroes the LLL's
 * preempt_req from the system work queue, the way the stray
 * peripheral_battery_levels[234] = 0 write in ZMK would on a build where
 * that byte is preempt_req. A monitor thread samples the preempt state every
 * 1 ms and logs stale periods (preempt_req != preempt_ack with no preempt
 * ticker start pending, for longer than STALE_MS) and late prepares.
 *
 * Args (-argstest): clobber=0|1|2 (2 = preempt_stop_ack) load=0|1 yield=0|1 lat_burst=us lat_period=us lat_isr=n
 * Log lines parsed by the run script: CLOBBER, STALE_BEGIN, STALE_END, STATS,
 * FINAL.
 */
#include <zephyr/kernel.h>
#include <string.h>
#include <stdio.h>
#include <errno.h>

#include "bs_types.h"
#include "bs_tracing.h"
#include "time_machine.h"
#include "bstests.h"

#include <zephyr/sys/printk.h>
#include <zephyr/bluetooth/bluetooth.h>
#include <zephyr/bluetooth/conn.h>
#include <zephyr/bluetooth/gap.h>

#include "preempt_clobber.h"
#include "gatt_sink.h"


extern enum bst_result_t bst_result;

#define FAIL(...)					\
	do {						\
		bst_result = Failed;			\
		bs_trace_error_time_line(__VA_ARGS__);	\
	} while (0)

#define PASS(...)					\
	do {						\
		bst_result = Passed;			\
		bs_trace_info_time(1, __VA_ARGS__);	\
	} while (0)

static struct bt_conn *split_conn;  /* DUT is CENTRAL on this link */
static struct bt_conn *host_conn;   /* DUT is PERIPHERAL on this link */
static volatile bool scanning;

static uint32_t clobber;
static uint32_t load;
static uint32_t yield_en;

/* LLL test hooks (subsys/bluetooth/controller/ll_sw/nordic/lll/lll.c). */
extern volatile uint32_t lll_test_overhead_cnt;
extern volatile uint32_t lll_test_preempt_skip_cnt;
extern volatile uint32_t lll_test_preempt_start_cnt;
void lll_test_preempt_req_set(uint8_t val);
void lll_test_preempt_stop_ack_set(uint8_t val);
void lll_test_preempt_stop_state(uint8_t *stop_req, uint8_t *stop_ack);
void lll_test_preempt_state(uint8_t *req, uint8_t *ack, uint8_t *start_req,
			    uint8_t *start_ack);

static uint32_t host_disconnects;
static uint32_t clobbers;
static uint32_t clobbers_effective; /* the target byte was nonzero, so it changed */

/* ---- CPU-latency injector ------------------------------------------------
 *
 * bsim executes all CPU work in ZERO simulated time, so the ULL/ISR latency a
 * real ZMK central experiences (kernel spinlock critical sections, SPI display
 * + kscan ISRs, and internal-flash writes/erases that stall the whole CPU for
 * 41 us .. 85 ms on nRF52) never occurs, and the controller's prepares are
 * always enqueued, preempted, and dequeued exactly on time. The June sweeps
 * varied only link GEOMETRY (intervals/drift/phase) and never overflowed.
 *
 * This thread periodically masks interrupts and burns simulated time, delaying
 * the radio/ticker ISRs the way real critical sections and flash stalls do:
 *   lat_burst  = irq-locked busy-wait length in us (0 = injector disabled)
 *   lat_period = sleep between bursts in us
 * Passed per-run via bsim test args: -argstest lat_burst=N lat_period=N
 */
static uint32_t lat_burst_us;
static uint32_t lat_period_us = 3300;

/* Injection mode (-argstest lat_isr=):
 *   0 - thread + irq_lock() + k_busy_wait(). Faithful, but SIGSEGVs the
 *       3.5-3.7-era simulator: an IRQ latched during the locked burst is
 *       dispatched at irq_unlock() through an unpopulated irq_vector_table
 *       entry (jump to a garbage address in posix_irq_handler).
 *   1 - k_busy_wait() inside a k_timer ISR. Crash-free but INERT: the
 *       simulator advances time with nested dispatch during the busy-wait,
 *       so the radio is serviced on schedule and nothing is delayed
 *       (verified: 4.0/4.1 stop reproducing under this mode).
 *   2 - (default) thread that irq_disable()s only the controller's own
 *       IRQs (RADIO, TIMER0, RTC0, SWI4, SWI5) around the busy-wait. Their
 *       vectors are populated, so re-enabling dispatches pending IRQs
 *       through valid entries on every tree era, while the radio genuinely
 *       waits out the burst. Only currently-enabled IRQs are touched.
 */
static uint32_t lat_isr = 2;

/* nRF52 controller IRQ numbers: RADIO=1, TIMER0=8, RTC0=11, SWI4=20, SWI5=21 */
static const unsigned int lat_masked_irqs[] = {1, 8, 11, 20, 21};

/* Generous stack: on the 3.5-3.7-era kernels a 1024 B stack for this thread
 * silently overflowed on the POSIX arch (no MPU) - corrupted ACL traffic then
 * a native SIGSEGV ~30 ms after arming, which masqueraded as a passing rung
 * until the verdict logic required end-of-sim evidence.
 */
static K_THREAD_STACK_DEFINE(lat_stack, 4096);
static struct k_thread lat_thread;

static void lat_burst_timer_cb(struct k_timer *timer)
{
	/* ISR context: the busy-wait stalls the simulator's sequential IRQ
	 * dispatch loop, delaying radio/ticker processing by the burst length.
	 */
	k_busy_wait(lat_burst_us);
}

static K_TIMER_DEFINE(lat_burst_timer, lat_burst_timer_cb, NULL);

static void lat_injector(void *p1, void *p2, void *p3)
{
	if (lat_isr == 1) {
		k_timer_start(&lat_burst_timer, K_USEC(lat_period_us),
			      K_USEC(lat_period_us));
		return;
	}

	while (true) {
		k_usleep(lat_period_us);

		if (lat_isr == 2) {
			uint32_t was = 0;

			for (int i = 0; i < ARRAY_SIZE(lat_masked_irqs); i++) {
				if (arch_irq_is_enabled(lat_masked_irqs[i])) {
					was |= BIT(i);
					irq_disable(lat_masked_irqs[i]);
				}
			}

			k_busy_wait(lat_burst_us);

			for (int i = 0; i < ARRAY_SIZE(lat_masked_irqs); i++) {
				if (was & BIT(i)) {
					irq_enable(lat_masked_irqs[i]);
				}
			}
		} else {
			unsigned int key = irq_lock();

			k_busy_wait(lat_burst_us);
			irq_unlock(key);
		}
	}
}

/* ---- the modeled stray write ------------------------------------------ */

static void clobber_work_handler(struct k_work *work)
{
	uint8_t req, ack, sreq, sack, stop_req, stop_ack;

	lll_test_preempt_state(&req, &ack, &sreq, &sack);
	lll_test_preempt_stop_state(&stop_req, &stop_ack);
	clobbers++;
	if (((clobber == 2U) ? stop_ack : req) != 0U) {
		clobbers_effective++;
	}
	printk("CLOBBER n=%u target=%s t_ms=%lld req=%u ack=%u start_req=%u start_ack=%u "
	       "stop_req=%u stop_ack=%u\n",
	       clobbers, (clobber == 2U) ? "stop_ack" : "req", k_uptime_get(), req, ack,
	       sreq, sack, stop_req, stop_ack);
	if (clobber == 2U) {
		/* Coron's production layout: the write lands one byte later. */
		lll_test_preempt_stop_ack_set(0U);
	} else {
		lll_test_preempt_req_set(0U);
	}
}

static K_WORK_DEFINE(clobber_work, clobber_work_handler);

/* ---- preempt state monitor -------------------------------------------- */

/* A real preempt timeout expires within one event (a few ms); req != ack for
 * longer than this, with no ticker start in flight, means the state is stale.
 */
#define STALE_MS 50

static uint32_t stale_periods;
static int64_t stale_total_ms;
static int64_t stale_max_ms;
static int64_t stale_since = -1;
static bool stale_reported;

static K_THREAD_STACK_DEFINE(mon_stack, 2048);
static struct k_thread mon_thread;

static void print_stats(const char *tag)
{
	int64_t cur = (stale_since >= 0) ? (k_uptime_get() - stale_since) : 0;

	printk("%s t_ms=%lld host_disc=%u clobbers=%u effective=%u overhead=%u "
	       "preempt_start=%u preempt_skip=%u stale_periods=%u stale_total_ms=%lld "
	       "stale_max_ms=%lld stale_now_ms=%lld\n",
	       tag, k_uptime_get(), host_disconnects, clobbers, clobbers_effective,
	       lll_test_overhead_cnt, lll_test_preempt_start_cnt,
	       lll_test_preempt_skip_cnt, stale_periods, stale_total_ms, stale_max_ms,
	       (stale_since >= 0 && stale_reported) ? cur : 0);
}

static void monitor(void *p1, void *p2, void *p3)
{
	int64_t last_stats = k_uptime_get();
	uint32_t last_overhead = 0;

	while (true) {
		uint8_t req, ack, sreq, sack;
		int64_t now;

		k_sleep(K_MSEC(1));
		now = k_uptime_get();
		lll_test_preempt_state(&req, &ack, &sreq, &sack);

		if ((req != ack) && (sreq == sack)) {
			if (stale_since < 0) {
				stale_since = now;
				stale_reported = false;
			} else if (!stale_reported && (now - stale_since) > STALE_MS) {
				stale_reported = true;
				stale_periods++;
				printk("STALE_BEGIN t_ms=%lld req=%u ack=%u\n",
				       stale_since, req, ack);
			}
		} else if (stale_since >= 0) {
			if (stale_reported) {
				int64_t dur = now - stale_since;

				stale_total_ms += dur;
				stale_max_ms = MAX(stale_max_ms, dur);
				printk("STALE_END t_ms=%lld dur_ms=%lld\n", now, dur);
			}
			stale_since = -1;
		}

		if (lll_test_overhead_cnt != last_overhead) {
			printk("OVERHEAD t_ms=%lld count=%u stale_now=%d\n", now,
			       lll_test_overhead_cnt, stale_reported ? 1 : 0);
			last_overhead = lll_test_overhead_cnt;
		}

		if (now - last_stats >= 10000) {
			print_stats("STATS");
			last_stats = now;
		}
	}
}

static void test_args_parse(int argc, char *argv[])
{
	for (int i = 0; i < argc; i++) {
		if (sscanf(argv[i], "lat_burst=%u", &lat_burst_us) == 1) {
			continue;
		}
		if (sscanf(argv[i], "lat_isr=%u", &lat_isr) == 1) {
			continue;
		}
		if (sscanf(argv[i], "lat_period=%u", &lat_period_us) == 1) {
			continue;
		}
		if (sscanf(argv[i], "clobber=%u", &clobber) == 1) {
			continue;
		}
		if (sscanf(argv[i], "load=%u", &load) == 1) {
			continue;
		}
		if (sscanf(argv[i], "yield=%u", &yield_en) == 1) {
			continue;
		}
	}
}

static const struct bt_data ad[] = {
	BT_DATA_BYTES(BT_DATA_FLAGS, (BT_LE_AD_GENERAL | BT_LE_AD_NO_BREDR)),
	BT_DATA(BT_DATA_NAME_COMPLETE, DUT_NAME, sizeof(DUT_NAME) - 1),
};

/* ---- find the split by advertised name ---------------------------------- */

struct name_match {
	const char *want;
	bool found;
};

static bool ad_name_cb(struct bt_data *data, void *user_data)
{
	struct name_match *m = user_data;

	if (data->type == BT_DATA_NAME_COMPLETE &&
	    data->data_len == strlen(m->want) &&
	    memcmp(data->data, m->want, data->data_len) == 0) {
		m->found = true;
		return false; /* stop parsing */
	}
	return true;
}

static void device_found(const bt_addr_le_t *addr, int8_t rssi, uint8_t type,
			 struct net_buf_simple *adv)
{
	struct name_match m = { .want = SPLIT_NAME, .found = false };
	struct bt_le_conn_param *param;
	int err;

	if (split_conn || (type != BT_GAP_ADV_TYPE_ADV_IND)) {
		return;
	}

	bt_data_parse(adv, ad_name_cb, &m);
	if (!m.found) {
		return;
	}

	if (bt_le_scan_stop() == 0) {
		scanning = false;
	}

	/* DUT is CENTRAL on the split link: 7.5 ms, latency 30 (matches the dump). */
	param = BT_LE_CONN_PARAM(SPLIT_INTERVAL_UNITS, SPLIT_INTERVAL_UNITS,
				 CONN_LATENCY, CONN_TIMEOUT_UNITS);
	err = bt_conn_le_create(addr, BT_CONN_LE_CREATE_CONN, param, &split_conn);
	if (err) {
		FAIL("DUT: create split connection failed (err %d)\n", err);
	}
}

/* ---- split link yield (models a config's split_yield.c) ----------------
 *
 * yield=1: while the host is disconnected, move the split link to 28.75 ms,
 * latency 7; switch back 150 ms after the host connects. Runs on the system
 * work queue, queued from the same disconnected callback as the clobber.
 */
#define YIELD_INTERVAL_UNITS 23U
#define YIELD_LATENCY        7U
#define YIELD_SETTLE_MS      150

static bool want_yield;

static void yield_work_handler(struct k_work *work)
{
	struct bt_le_conn_param param = {
		.interval_min = want_yield ? YIELD_INTERVAL_UNITS : SPLIT_INTERVAL_UNITS,
		.interval_max = want_yield ? YIELD_INTERVAL_UNITS : SPLIT_INTERVAL_UNITS,
		.latency = want_yield ? YIELD_LATENCY : CONN_LATENCY,
		.timeout = CONN_TIMEOUT_UNITS,
	};
	int err;

	if (!split_conn) {
		return;
	}
	err = bt_conn_le_param_update(split_conn, &param);
	printk("YIELD %s t_ms=%lld err=%d\n", want_yield ? "slow" : "fast", k_uptime_get(),
	       err);
}

static K_WORK_DELAYABLE_DEFINE(yield_work, yield_work_handler);

static void le_param_updated(struct bt_conn *conn, uint16_t interval, uint16_t latency,
			     uint16_t timeout)
{
	if (conn == split_conn) {
		printk("SPLIT_PARAMS t_ms=%lld interval=%u latency=%u\n", k_uptime_get(),
		       interval, latency);
	}
}

static void adv_work_handler(struct k_work *work)
{
	int err = bt_le_adv_start(BT_LE_ADV_CONN_FAST_1, ad, ARRAY_SIZE(ad), NULL, 0);

	if (err && err != -EALREADY) {
		printk("DUT re-advertise failed (err %d)\n", err);
	}
}

static K_WORK_DEFINE(adv_work, adv_work_handler);

static void connected(struct bt_conn *conn, uint8_t err)
{
	struct bt_conn_info info;

	if (err) {
		printk("DUT connect failed (err 0x%02x)\n", err);
		return;
	}
	if (bt_conn_get_info(conn, &info) != 0) {
		return;
	}

	if (info.role == BT_CONN_ROLE_CENTRAL) {
		printk("DUT connected to split (central link)\n");
	} else {
		host_conn = bt_conn_ref(conn);
		printk("DUT connected to host (peripheral link) t_ms=%lld\n", k_uptime_get());
		if (yield_en) {
			want_yield = false;
			k_work_reschedule(&yield_work, K_MSEC(YIELD_SETTLE_MS));
		}
	}
}

static void disconnected(struct bt_conn *conn, uint8_t reason)
{
	printk("DUT disconnected (reason 0x%02x) t_ms=%lld\n", reason, k_uptime_get());
	if (conn == split_conn) {
		FAIL("DUT lost the split link (reason 0x%02x)\n", reason);
		bt_conn_unref(split_conn);
		split_conn = NULL;
	} else if (conn == host_conn) {
		bt_conn_unref(host_conn);
		host_conn = NULL;
		host_disconnects++;
		/* ZMK's split_central_disconnected() fires for every conn and
		 * queues the bad battery event to the system work queue.
		 */
		if (clobber) {
			k_work_submit(&clobber_work);
		}
		if (yield_en) {
			want_yield = true;
			k_work_reschedule(&yield_work, K_NO_WAIT);
		}
	}
}

static void recycled(void)
{
	if (!host_conn) {
		k_work_submit(&adv_work);
	}
}

static struct bt_conn_cb conn_callbacks = {
	.connected = connected,
	.disconnected = disconnected,
	.recycled = recycled,
	.le_param_updated = le_param_updated,
};

static void dut_main(void)
{
	uint16_t split_sink;
	int err;

	bt_conn_cb_register(&conn_callbacks);

	err = bt_enable(NULL);
	if (err) {
		FAIL("DUT bt_enable failed (err %d)\n", err);
		return;
	}

	err = bt_le_adv_start(BT_LE_ADV_CONN_FAST_1, ad, ARRAY_SIZE(ad), NULL, 0);
	if (err) {
		FAIL("DUT advertising failed (err %d)\n", err);
		return;
	}
	printk("DUT advertising as %s\n", DUT_NAME);

	err = bt_le_scan_start(BT_LE_SCAN_PASSIVE, device_found);
	if (err) {
		FAIL("DUT scan start failed (err %d)\n", err);
		return;
	}
	scanning = true;

	while (!split_conn) {
		k_sleep(K_MSEC(20));
		if (bst_result == Failed) {
			return;
		}
	}
	k_sleep(K_MSEC(SETTLE_DELAY_MS));

	if (sink_discover(split_conn, &split_sink) != 0) {
		FAIL("DUT could not discover split sink\n");
		return;
	}

	k_thread_create(&mon_thread, mon_stack, K_THREAD_STACK_SIZEOF(mon_stack),
			monitor, NULL, NULL, NULL, K_PRIO_PREEMPT(1), 0, K_NO_WAIT);
	printk("DUT config: clobber=%u load=%u yield=%u lat_burst=%u lat_period=%u\n",
	       clobber, load, yield_en, lat_burst_us, lat_period_us);

	if (lat_burst_us > 0) {
		k_thread_create(&lat_thread, lat_stack, K_THREAD_STACK_SIZEOF(lat_stack),
				lat_injector, NULL, NULL, NULL,
				K_PRIO_PREEMPT(0), 0, K_NO_WAIT);
	}

	while (split_conn) {
		sink_blast_one(split_conn, split_sink);
		if (!load) {
			k_sleep(K_MSEC(LIGHT_WRITE_MS));
		}
	}
}

static void dut_init(void)
{
	bst_ticker_set_next_tick_absolute(WAIT_TIME * 1e6);
	bst_result = In_progress;
}

static void dut_tick(bs_time_t HW_device_time)
{
	print_stats("FINAL");
	if (bst_result == In_progress) {
		PASS("DUT survived %i s\n", WAIT_TIME);
	}
}

static const struct bst_test_instance dut_tests[] = {
	{
		.test_id = "dut",
		.test_descr = "Dual-role DUT; optionally zeroes preempt_req on each "
			      "host disconnect (ZMK stray-write model).",
		.test_args_f = test_args_parse,
		.test_pre_init_f = dut_init,
		.test_tick_f = dut_tick,
		.test_main_f = dut_main,
	},
	BSTEST_END_MARKER,
};

struct bst_test_list *test_dut_install(struct bst_test_list *tests)
{
	return bst_add_tests(tests, dut_tests);
}
```

## src/gatt_sink.c
```c
/*
 * Copyright (c) 2026 The ZMK Contributors
 * SPDX-License-Identifier: Apache-2.0
 */
#include <zephyr/kernel.h>
#include <errno.h>
#include <zephyr/sys/printk.h>

#include <zephyr/bluetooth/bluetooth.h>
#include <zephyr/bluetooth/conn.h>
#include <zephyr/bluetooth/gatt.h>
#include <zephyr/bluetooth/uuid.h>

#include "preempt_clobber.h"
#include "gatt_sink.h"

/* ---- Server side: every device exposes the sink characteristic ---------- */

static volatile uint32_t sink_rx_count;

static ssize_t sink_write_cb(struct bt_conn *conn, const struct bt_gatt_attr *attr,
			     const void *buf, uint16_t len, uint16_t offset, uint8_t flags)
{
	ARG_UNUSED(conn);
	ARG_UNUSED(attr);
	ARG_UNUSED(buf);
	ARG_UNUSED(offset);
	ARG_UNUSED(flags);
	sink_rx_count++;
	return len;
}

BT_GATT_SERVICE_DEFINE(sink_svc,
	BT_GATT_PRIMARY_SERVICE(BT_UUID_DECLARE_128(SINK_SVC_UUID)),
	BT_GATT_CHARACTERISTIC(BT_UUID_DECLARE_128(SINK_CHR_UUID),
			       BT_GATT_CHRC_WRITE_WITHOUT_RESP, BT_GATT_PERM_WRITE,
			       NULL, sink_write_cb, NULL));

/* ---- Client side: discover the value handle, then blast max writes ------ */

static struct bt_uuid_128 sink_chr_uuid = BT_UUID_INIT_128(SINK_CHR_UUID);
static struct bt_gatt_discover_params disc_params;
static uint16_t disc_handle;
static K_SEM_DEFINE(disc_done, 0, 1);

static uint8_t disc_cb(struct bt_conn *conn, const struct bt_gatt_attr *attr,
		       struct bt_gatt_discover_params *params)
{
	if (attr) {
		disc_handle = bt_gatt_attr_value_handle(attr);
	}
	k_sem_give(&disc_done);
	return BT_GATT_ITER_STOP;
}

int sink_discover(struct bt_conn *conn, uint16_t *handle)
{
	int err;

	disc_handle = 0U;
	k_sem_reset(&disc_done);

	disc_params.uuid = &sink_chr_uuid.uuid;
	disc_params.func = disc_cb;
	disc_params.start_handle = 0x0001U;
	disc_params.end_handle = 0xffffU;
	disc_params.type = BT_GATT_DISCOVER_CHARACTERISTIC;

	err = bt_gatt_discover(conn, &disc_params);
	if (err) {
		printk("sink discover start failed (err %d)\n", err);
		return err;
	}

	if (k_sem_take(&disc_done, K_SECONDS(5)) != 0 || disc_handle == 0U) {
		printk("sink discover did not complete\n");
		return -ETIMEDOUT;
	}

	*handle = disc_handle;
	printk("sink characteristic value handle = 0x%04x\n", disc_handle);
	return 0;
}

void sink_blast_one(struct bt_conn *conn, uint16_t handle)
{
	static uint8_t payload[SINK_WRITE_LEN];
	int err;

	/* Retry on tx-buffer exhaustion so events stay full; bail if the conn
	 * goes away (write returns -ENOTCONN).
	 */
	do {
		err = bt_gatt_write_without_response(conn, handle, payload,
						     sizeof(payload), false);
		if (err == -ENOMEM || err == -ENOBUFS || err == -EAGAIN) {
			k_sleep(K_MSEC(1));
			continue;
		}
		break;
	} while (true);

	if (err && err != -ENOTCONN) {
		/* Unexpected; don't spam, just yield. */
		k_sleep(K_MSEC(1));
	}
}
```

## src/gatt_sink.h
```c
/*
 * Copyright (c) 2026 The ZMK Contributors
 * SPDX-License-Identifier: Apache-2.0
 *
 * Write-without-response "sink": server attribute + client blaster, shared by
 * the roles to saturate each link (long events -> forced overlap).
 */
#ifndef GATT_SINK_H_
#define GATT_SINK_H_

#include <zephyr/bluetooth/conn.h>

/* Discover the sink characteristic value handle on `conn`. Blocks (test thread
 * context only). Returns 0 and writes *handle on success, negative on error.
 */
int sink_discover(struct bt_conn *conn, uint16_t *handle);

/* Push one max-size write-without-response toward `handle` on `conn`, retrying
 * on tx-buffer exhaustion so every connection event stays full. Returns after a
 * write is queued (or the conn drops).
 */
void sink_blast_one(struct bt_conn *conn, uint16_t handle);

#endif /* GATT_SINK_H_ */
```

## src/host.c
```c
/*
 * Copyright (c) 2026 The ZMK Contributors
 * SPDX-License-Identifier: Apache-2.0
 *
 * Device 2 - the "host". A central that connects to the DUT, writes to it
 * (load=1 saturates, load=0 is typing-rate), and every cycle_ms drops the link,
 * waits gap_ms and reconnects - the host disconnects that trigger the ZMK stray write.
 *
 * Args (-argstest): cycle_ms=N (0 = never disconnect) gap_ms=N load=0|1
 *                   host_int=N (connection interval, 1.25 ms units)
 */
#include <zephyr/kernel.h>
#include <string.h>
#include <errno.h>
#include <stdio.h>

#include "bs_types.h"
#include "bs_tracing.h"
#include "time_machine.h"
#include "bstests.h"

#include <zephyr/sys/printk.h>
#include <zephyr/bluetooth/bluetooth.h>
#include <zephyr/bluetooth/conn.h>
#include <zephyr/bluetooth/gap.h>

#include "preempt_clobber.h"
#include "gatt_sink.h"


extern enum bst_result_t bst_result;

#define FAIL(...)					\
	do {						\
		bst_result = Failed;			\
		bs_trace_error_time_line(__VA_ARGS__);	\
	} while (0)

#define PASS(...)					\
	do {						\
		bst_result = Passed;			\
		bs_trace_info_time(1, __VA_ARGS__);	\
	} while (0)

static struct bt_conn *dut_conn;
static volatile bool dut_connected;

static uint32_t cycle_ms = 20000;
static uint32_t gap_ms = 1000;
static uint32_t load;
static uint32_t host_int = HOST_INTERVAL_UNITS;

static uint32_t conn_ok;
static uint32_t conn_fail;

static void test_args_parse(int argc, char *argv[])
{
	for (int i = 0; i < argc; i++) {
		if (sscanf(argv[i], "cycle_ms=%u", &cycle_ms) == 1) {
			continue;
		}
		if (sscanf(argv[i], "gap_ms=%u", &gap_ms) == 1) {
			continue;
		}
		if (sscanf(argv[i], "load=%u", &load) == 1) {
			continue;
		}
		if (sscanf(argv[i], "host_int=%u", &host_int) == 1) {
			continue;
		}
	}
}

struct name_match {
	const char *want;
	bool found;
};

static bool ad_name_cb(struct bt_data *data, void *user_data)
{
	struct name_match *m = user_data;

	if (data->type == BT_DATA_NAME_COMPLETE &&
	    data->data_len == strlen(m->want) &&
	    memcmp(data->data, m->want, data->data_len) == 0) {
		m->found = true;
		return false;
	}
	return true;
}

static void device_found(const bt_addr_le_t *addr, int8_t rssi, uint8_t type,
			 struct net_buf_simple *adv)
{
	struct name_match m = { .want = DUT_NAME, .found = false };
	struct bt_le_conn_param *param;
	int err;

	if (dut_conn || (type != BT_GAP_ADV_TYPE_ADV_IND)) {
		return;
	}

	bt_data_parse(adv, ad_name_cb, &m);
	if (!m.found) {
		return;
	}

	(void)bt_le_scan_stop();

	param = BT_LE_CONN_PARAM(host_int, host_int, CONN_LATENCY, CONN_TIMEOUT_UNITS);
	err = bt_conn_le_create(addr, BT_CONN_LE_CREATE_CONN, param, &dut_conn);
	if (err) {
		printk("Host: create DUT connection failed (err %d)\n", err);
		dut_conn = NULL;
	}
}

static void connected(struct bt_conn *conn, uint8_t err)
{
	if (err) {
		/* e.g. 0x3e, connection failed to be established */
		conn_fail++;
		printk("HOST_CONN_FAIL err=0x%02x t_ms=%lld\n", err, k_uptime_get());
		if (conn == dut_conn) {
			bt_conn_unref(dut_conn);
			dut_conn = NULL;
		}
		return;
	}
	conn_ok++;
	dut_connected = true;
	printk("Host connected to DUT t_ms=%lld\n", k_uptime_get());
}

static void disconnected(struct bt_conn *conn, uint8_t reason)
{
	printk("Host disconnected (reason 0x%02x) t_ms=%lld\n", reason, k_uptime_get());
	if (conn == dut_conn) {
		dut_connected = false;
		bt_conn_unref(dut_conn);
		dut_conn = NULL;
	}
}

static struct bt_conn_cb conn_callbacks = {
	.connected = connected,
	.disconnected = disconnected,
};

static void host_main(void)
{
	uint16_t dut_sink;
	int err;

	bt_conn_cb_register(&conn_callbacks);

	err = bt_enable(NULL);
	if (err) {
		FAIL("Host bt_enable failed (err %d)\n", err);
		return;
	}

	while (true) {
		int64_t up_since;

		err = bt_le_scan_start(BT_LE_SCAN_PASSIVE, device_found);
		if (err && err != -EALREADY) {
			printk("Host scan start failed (err %d)\n", err);
			k_sleep(K_MSEC(100));
			continue;
		}

		while (!dut_connected) {
			k_sleep(K_MSEC(20));
			if (!dut_conn) {
				/* Connect attempt failed; scan again. */
				(void)bt_le_scan_start(BT_LE_SCAN_PASSIVE, device_found);
			}
		}
		k_sleep(K_MSEC(SETTLE_DELAY_MS));

		dut_sink = 0U;
		if (dut_connected && sink_discover(dut_conn, &dut_sink) != 0) {
			printk("Host could not discover DUT sink\n");
		}

		up_since = k_uptime_get();
		while (dut_connected &&
		       (cycle_ms == 0 || (k_uptime_get() - up_since) < cycle_ms)) {
			if (dut_sink) {
				sink_blast_one(dut_conn, dut_sink);
			}
			if (!load || !dut_sink) {
				k_sleep(K_MSEC(LIGHT_WRITE_MS));
			}
		}

		if (dut_connected) {
			(void)bt_conn_disconnect(dut_conn, BT_HCI_ERR_REMOTE_USER_TERM_CONN);
		}
		while (dut_connected || dut_conn) {
			k_sleep(K_MSEC(10));
		}
		k_sleep(K_MSEC(gap_ms));
	}
}

static void host_init(void)
{
	bst_ticker_set_next_tick_absolute(WAIT_TIME * 1e6);
	bst_result = In_progress;
}

static void host_tick(bs_time_t HW_device_time)
{
	printk("HOST_FINAL conn_ok=%u conn_fail=%u\n", conn_ok, conn_fail);
	if (bst_result == In_progress) {
		PASS("Host completed run\n");
	}
}

static const struct bst_test_instance host_tests[] = {
	{
		.test_id = "host",
		.test_descr = "Host central: connects to the DUT, loads its peripheral "
			      "link and cycles the connection.",
		.test_args_f = test_args_parse,
		.test_pre_init_f = host_init,
		.test_tick_f = host_tick,
		.test_main_f = host_main,
	},
	BSTEST_END_MARKER,
};

struct bst_test_list *test_host_install(struct bst_test_list *tests)
{
	return bst_add_tests(tests, host_tests);
}
```

## src/preempt_clobber.h
```c
/*
 * Copyright (c) 2026 The ZMK Contributors
 *
 * SPDX-License-Identifier: Apache-2.0
 *
 * Shared parameters for the preempt_req clobber test.
 *
 * Topology (mirrors a ZMK split CENTRAL, reused from the prep_pipeline repro):
 *
 *   host (central) --> DUT (peripheral + central) --7.5ms--> split (peripheral)
 *
 * A ZMK bug report says that every host disconnect on a ZMK split central with
 * CONFIG_ZMK_SPLIT_BLE_CENTRAL_BATTERY_LEVEL_FETCHING=y writes a 0 byte 234
 * bytes past peripheral_battery_levels[], and claims that on one build that
 * byte is the LLL's static preempt_req, which then stalls preempt timeouts
 * for ~256 s and trips LL_ASSERT_OVERHEAD. bsim cannot reproduce the memory
 * layout, so the DUT models the stray write directly: on each host disconnect
 * it sets preempt_req = 0 through a test hook (LLL_TEST_PREEMPT_HOOKS), from
 * the system work queue like the ZMK write. clobber=0 is the control.
 */
#ifndef PREEMPT_CLOBBER_H_
#define PREEMPT_CLOBBER_H_

/* Sim length; the run script's -sim_length must be slightly longer. Long
 * enough to see the claimed ~256 s recovery (2^23 ticks at 32768 Hz).
 */
#define WAIT_TIME 300 /* seconds */

#define SPLIT_INTERVAL_UNITS 6U  /* 7.5 ms (DUT is central here) */
/* Default host interval: 7 units (8.75 ms), coprime to the split's 6 so the
 * two links beat through every phase with zero drift. host_int=12 gives the
 * 15 ms a PC typically picks (2x the split interval).
 */
#define HOST_INTERVAL_UNITS  7U
#define CONN_LATENCY         0U
#define CONN_TIMEOUT_UNITS   400U /* 4 s (10 ms units) */

#define DUT_NAME   "bsim_dut"
#define SPLIT_NAME "bsim_split"

#define SINK_SVC_UUID \
	BT_UUID_128_ENCODE(0x9a7c0001, 0xbeef, 0x4d0e, 0x9e1a, 0xc0ffee0f100d)
#define SINK_CHR_UUID \
	BT_UUID_128_ENCODE(0x9a7c0002, 0xbeef, 0x4d0e, 0x9e1a, 0xc0ffee0f100d)

#define SINK_WRITE_LEN 20

/* load=0 ("light"): one write every LIGHT_WRITE_MS, roughly typing-rate HID
 * traffic. load=1 ("sat"): back-to-back writes, long overlapping events.
 */
#define LIGHT_WRITE_MS 10

#define SETTLE_DELAY_MS 500

#endif /* PREEMPT_CLOBBER_H_ */
```

## src/split.c
```c
/*
 * Copyright (c) 2026 The ZMK Contributors
 * SPDX-License-Identifier: Apache-2.0
 *
 * Device 0 - the "split peripheral". Advertises connectably as SPLIT_NAME,
 * accepts the DUT's central connection, and idles as a write sink (the global
 * sink service in gatt_sink.c absorbs the DUT's max-size writes, lengthening the
 * split-link events). Never disconnects.
 */
#include <zephyr/kernel.h>
#include <string.h>

#include "bs_types.h"
#include "bs_tracing.h"
#include "time_machine.h"
#include "bstests.h"

#include <zephyr/sys/printk.h>
#include <zephyr/bluetooth/bluetooth.h>
#include <zephyr/bluetooth/conn.h>

#include "preempt_clobber.h"


extern enum bst_result_t bst_result;

#define FAIL(...)					\
	do {						\
		bst_result = Failed;			\
		bs_trace_error_time_line(__VA_ARGS__);	\
	} while (0)

#define PASS(...)					\
	do {						\
		bst_result = Passed;			\
		bs_trace_info_time(1, __VA_ARGS__);	\
	} while (0)

static volatile bool connected_flag;

static const struct bt_data ad[] = {
	BT_DATA_BYTES(BT_DATA_FLAGS, (BT_LE_AD_GENERAL | BT_LE_AD_NO_BREDR)),
	BT_DATA(BT_DATA_NAME_COMPLETE, SPLIT_NAME, sizeof(SPLIT_NAME) - 1),
};

static void connected(struct bt_conn *conn, uint8_t err)
{
	if (err) {
		FAIL("Split failed to connect (err 0x%02x)\n", err);
		return;
	}
	connected_flag = true;
	printk("Split connected (central=DUT)\n");
	PASS("Split connected; serving as write sink\n");
}

static void disconnected(struct bt_conn *conn, uint8_t reason)
{
	printk("Split disconnected (reason 0x%02x)\n", reason);
	connected_flag = false;
}

static struct bt_conn_cb conn_callbacks = {
	.connected = connected,
	.disconnected = disconnected,
};

static void split_main(void)
{
	int err;

	bt_conn_cb_register(&conn_callbacks);

	err = bt_enable(NULL);
	if (err) {
		FAIL("Split bt_enable failed (err %d)\n", err);
		return;
	}

	err = bt_le_adv_start(BT_LE_ADV_CONN_FAST_1, ad, ARRAY_SIZE(ad), NULL, 0);
	if (err) {
		FAIL("Split advertising failed (err %d)\n", err);
		return;
	}
	printk("Split advertising as %s\n", SPLIT_NAME);

	/* Idle; the sink service absorbs writes. Survive the whole sim. */
	while (true) {
		k_sleep(K_MSEC(SETTLE_DELAY_MS));
	}
}

static void split_init(void)
{
	bst_ticker_set_next_tick_absolute(WAIT_TIME * 1e6);
	bst_result = In_progress;
}

static void split_tick(bs_time_t HW_device_time)
{
	/* Surviving to the deadline still connected is success for this peer. */
	if (bst_result != Passed) {
		FAIL("split: not connected after %i seconds\n", WAIT_TIME);
	}
}

static const struct bst_test_instance split_tests[] = {
	{
		.test_id = "split",
		.test_descr = "Split peripheral: connectable write sink for the DUT.",
		.test_pre_init_f = split_init,
		.test_tick_f = split_tick,
		.test_main_f = split_main,
	},
	BSTEST_END_MARKER,
};

struct bst_test_list *test_split_install(struct bst_test_list *tests)
{
	return bst_add_tests(tests, split_tests);
}
```
