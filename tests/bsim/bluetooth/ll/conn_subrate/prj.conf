## CMakeLists.txt
```
# SPDX-License-Identifier: Apache-2.0

cmake_minimum_required(VERSION 3.20.0)

find_package(Zephyr REQUIRED HINTS $ENV{ZEPHYR_BASE})
project(bsim_test_conn_subrate)

target_sources(app PRIVATE
  src/main.c
  src/central.c
  src/peripheral.c
)

# The bsim test framework headers (bstests.h, bs_types.h, bs_tracing.h,
# time_machine.h) live in the BabbleSim components; the board only adds these
# to its own library scope, so app sources need them added globally.
zephyr_include_directories(
  ${BSIM_COMPONENTS_PATH}/libUtilv1/src/
  ${BSIM_COMPONENTS_PATH}/libPhyComv1/src/
)
```

## prj.conf
```kconfig
CONFIG_BT=y
CONFIG_LOG=y
CONFIG_BT_CENTRAL=y
CONFIG_BT_PERIPHERAL=y
CONFIG_BT_GATT_CLIENT=y
CONFIG_BT_DEVICE_NAME="bsim_subrate"

# Keep the connection interval fixed: the peripheral's ~5s auto-update to its
# preferred params would otherwise change the interval and reset subrating
# mid-test (the test controls interval changes explicitly).
CONFIG_BT_GAP_AUTO_UPDATE_CONN_PARAMS=n

# LE Connection Subrating: host API (bt_conn_le_subrate_*) + Set Host Feature
# bit, and the controller-side negotiation + peripheral event skipping.
CONFIG_BT_SUBRATING=y
CONFIG_BT_CTLR_SUBRATING=y

# PHY update (le_phy_updated callback) for the PHY-update-while-subrated test.
CONFIG_BT_USER_PHY_UPDATE=y

# Heart Rate Service for the notifications-under-subrating test.
CONFIG_BT_HRS=y

# Per-connection event counter for the central-cadence regression test
# (central_lat_count): asserts the central honors its subrate skip and does not
# burst to full rate on the peripheral's stacked-latency skipped events.
CONFIG_BT_CTLR_TEST_CONN_EVENT_COUNT=y

# The central_multi test holds two simultaneous links on the central.
CONFIG_BT_MAX_CONN=3
```

## overlay-ecv-load-dt.conf
```kconfig
# DUAL-TIMER A/B arm of the ECV-under-ZMK-split-load floor scenario.
#
# Byte-for-byte the same load and feature composition as overlay-ecv-load.conf
# (.conf files cannot #include, so the body below is copied verbatim), with ONE
# added line: CONFIG_BT_CTLR_SW_SWITCH_SINGLE_TIMER=n. That flips the nRF54L
# controller from the single-TIMER10 architecture (EVENT_TIMER and
# SW_SWITCH_TIMER share NRF_TIMER10) to the dual-timer architecture backported
# from upstream PR #109528: EVENT_TIMER = NRF_TIMER00 (MCU power domain, HFPLL
# 128 MHz) with SW_SWITCH_TIMER = NRF_TIMER10 (Radio domain), bridged by PPIB.
#
# The hypothesis under test: the single-timer per-event overhead
# (HAL_RADIO_ISR_LATENCY_MAX_US = 80 us, inside the abort/overhead threshold and
# fed to lll_preempt_calc) is a cause of the measured ECV floor (93% @ 750 us,
# 89% @ 625 us). In dual-timer mode radio_nrf5_resources.h automatically drops
# that constant to 0 (the nRF52840 dual-timer value), which is the mechanism the
# A/B isolates. Run this arm against overlay-ecv-load.conf's single-timer
# numbers with an otherwise identical build (same FSU 80 us tIFS, same 2M PHY,
# same 1-notification-per-CE load, same FAST radio ramp-up) so the ONLY variable
# is the timer architecture.
#
# CI wires this arm continue-on-error: it is an experimental backport and must
# never gate the branch.
CONFIG_BT_LE_EXTENDED_FEAT_SET=y
CONFIG_BT_LE_MAX_LOCAL_SUPPORTED_FEATURE_PAGE=1
CONFIG_BT_SHORTER_CONNECTION_INTERVALS=y
CONFIG_BT_FRAME_SPACE_UPDATE=y
CONFIG_BT_CTLR_FRAME_SPACE_UPDATE=y
CONFIG_BT_CTLR_FSU_MIN_FRAME_SPACE_US=80

CONFIG_BT_CTLR_SCI_ECV_INTERVAL_MIN_125US=3

CONFIG_BT_CTLR_ADVANCED_FEATURES=y
CONFIG_BT_CTLR_ASSERT_OVERHEAD_START=n

CONFIG_BT_BUF_ACL_TX_COUNT=8

# --- Dual-timer A/B: the one line that distinguishes this arm ---
# BT_CTLR_ADVANCED_FEATURES (above) makes the symbol assignable; the Kconfig
# no longer force-selects single-timer on nRF54L (BT_CTLR_RADIO_ENABLE_FAST kept
# its FAST ramp-up default but dropped the select), so =n here actually sticks
# and selects the NRF_TIMER00 EVENT_TIMER dual-timer path.
CONFIG_BT_CTLR_SW_SWITCH_SINGLE_TIMER=n
```

## overlay-ecv-load.conf
```kconfig
# Overlay for the ECV-under-ZMK-split-load floor scenario: composes Shorter
# Connection Intervals (the ECV 125 us interval tier) WITH Frame Space Update
# (the negotiated sub-150 us tIFS) in one controller build -- the load-bearing
# re-test of the empty-PDU floor sweep, and the airtime-vs-scheduler
# discriminator (the same load runs with and without the FSU negotiation).
# Both features live on LL feature page 1, so the Extended Feature Set is on.
CONFIG_BT_LE_EXTENDED_FEAT_SET=y
CONFIG_BT_LE_MAX_LOCAL_SUPPORTED_FEATURE_PAGE=1
CONFIG_BT_SHORTER_CONNECTION_INTERVALS=y
CONFIG_BT_FRAME_SPACE_UPDATE=y
CONFIG_BT_CTLR_FRAME_SPACE_UPDATE=y
CONFIG_BT_CTLR_FSU_MIN_FRAME_SPACE_US=80

# ECV floor at the Core 6.2 spec minimum (3 = 375 us), NOT the 625 us nRF54L15
# hardware floor overlay-sci.conf models: this scenario's informational probes
# deliberately step below the measured floor ({500, 375} us) to record where
# degradation happens on the idealized bsim radio, so the controller must
# accept the requests (all three enforcement sites -- the PDU codec, the HCI
# req_send check, and the peer-REQ acceptance -- key off this one symbol). The
# asserting gate stays {750, 625} us; the floor-vs-hardware question is the
# probes' data, not a production default (production keeps 5/625 us).
CONFIG_BT_CTLR_SCI_ECV_INTERVAL_MIN_125US=3

# Below the validated floor the ticker can decide an event would start late;
# skip it gracefully instead of asserting (the skip shows up as a delivered-
# rate shortfall, which is exactly what the gate's 90% floor and the probes'
# RESULT lines measure -- nothing is masked). Same relaxation the original
# floor-sweep spike used. BT_CTLR_ADVANCED_FEATURES makes the symbol visible;
# without it the =n assignment is silently dropped (menu "Advanced features",
# Kconfig.ll_sw_split). NOTE: the sub-625 us probes may still terminate in a
# prepare-pipeline / done-pool assert (the spike's CONFIG_BT_CTLR_EVENT_DONE_MAX
# pool tunable is not on this branch); their CI step is continue-on-error and
# an assert there is itself the recorded floor datum.
CONFIG_BT_CTLR_ADVANCED_FEATURES=y
CONFIG_BT_CTLR_ASSERT_OVERHEAD_START=n

# Host TX headroom for a sustained 1-notification-per-CE stream at sub-ms
# intervals (default is 3 ACL TX buffers; L2CAP/ATT counts follow this symbol).
# Backpressure would show as bt_gatt_notify -ENOMEM on the peripheral -- a rate
# shortfall, not a test error, but do not let host buffer sizing be the thing
# the scenario measures.
CONFIG_BT_BUF_ACL_TX_COUNT=8
```

## overlay-ecv-spike.conf
```kconfig
# ECV scheduling feasibility spike (central_ecv_sweep): push the split link
# below 1.25 ms via the low-latency reduced-reservation path and sweep the
# sub-1.25 ms band {1000,875,750,625,500} us under a concurrent 30 ms link, on
# nrf54l15bsim (the single-timer primary SoC). This is the ECV go/no-go: does
# LL_SW hold a sub-1.25 ms anchor under split contention, and down to what floor.
# Isolated as an overlay so the >=7.5 ms subrating / SCI / EFS scenarios (which
# never request sub-7.5 ms and never engage the low-latency path) are unaffected.

# Drops the controller's CPR interval floor (CONN_INTERVAL_MIN) and engages the
# reduced-reservation / is_abort_cb anchor-sync path for interval < 6 units.
CONFIG_BT_CTLR_CONN_INTERVAL_LOW_LATENCY=y

# Prerequisite that makes the low-latency symbol overridable -- without it,
# LOW_LATENCY=y is silently ignored (visible-if gate in Kconfig.ll_sw_split).
CONFIG_BT_CTLR_ADVANCED_FEATURES=y

# Disables the host's 7.5 ms-minimum connection-parameter validation so the
# sub-7.5 ms param update reaches the controller.
CONFIG_BT_CONN_PARAM_ANY=y

# Under sub-1.25 ms contention the prepare path may see non-zero preempt
# overhead. With this assert ON (the LL_SW default) that path k_oops-es (crash,
# no data); with it OFF the event gracefully aborts (-ECANCELED) and the lost
# event simply shows up as reduced cadence -- which is exactly the metric the
# sweep measures. (Matches the iso-hybrid-split finding that the assert must be
# off for sub-7.5 ms scheduling alongside other links.)
CONFIG_BT_CTLR_ASSERT_OVERHEAD_START=n

# Done-extra pool. The auto default for this !ADV_EXT build is 4; the {750,625}us
# gate is green at the default too (run 26654390506). Kept at 12 here as the
# realistic sub-ms-ECV sizing and for margin -- the floor probe (run 26668227699)
# showed nRF52's sub-625us floor WAS done-extra-pool-bound (reached 375us with the
# bigger pool), while nRF54L's is pipeline-bound (raising this just moves the
# assert to the prepare pipeline, lll.c:892 / EVENT_PIPELINE_MAX=7), so ~625us is
# the nRF54L floor regardless. See conn_subrate.h for the measured floors.
CONFIG_BT_CTLR_EVENT_DONE_MAX=12
```

## overlay-efs.conf
```kconfig
# Overlay to compile the controller-side LL Extended Feature Set code in a real
# LL_SW build (nrf52_bsim), which the host-only bluetooth.shell EFS test
# (BT_LL_SW_SPLIT=n) does NOT exercise. CONFIG_BT_LE_EXTENDED_FEAT_SET=y (host)
# turns on CONFIG_BT_CTLR_EXTENDED_FEAT_SET (default y if the host symbol) now
# that LL_SW selects BT_CTLR_EXTENDED_FEAT_SET_SUPPORT. Used as a build-only
# compile gate; EFS does not exchange feature pages on air until the procedure +
# HCI backends land (later steps).
CONFIG_BT_LE_EXTENDED_FEAT_SET=y
CONFIG_BT_LE_MAX_LOCAL_SUPPORTED_FEATURE_PAGE=1
```

## overlay-fsu.conf
```kconfig
# Overlay to compile (and later run) the Frame Space Update (FSU) controller
# code in a real LL_SW build. FSU (Core 6.2, LL feature bit 65) negotiates a
# shorter/longer inter-frame space (T_IFS, default 150 us) per connection via
# the LL_FRAME_SPACE_REQ/RSP procedure, shrinking each connection event's air
# time and scheduler slot reservation.
#
# Like SCI, the FSU feature bit lives on LL feature page 1, so the LL Extended
# Feature Set is required (host + controller). FSU also requires Extended Reject
# Indication (auto-selected by BT_CTLR_FRAME_SPACE_UPDATE). Unlike SCI there is
# no host feature-support bit (bit 65 is Host-Controlled = N), so no
# BT_CTLR_SET_HOST_FEATURE dance.
CONFIG_BT_LE_EXTENDED_FEAT_SET=y
CONFIG_BT_LE_MAX_LOCAL_SUPPORTED_FEATURE_PAGE=1
# Host half: upstream 4.4's in-tree FSU host API (the 4.1 fork carried its own
# host commit, dropped in this port; the central_fsu test registration is
# guarded on this symbol).
CONFIG_BT_FRAME_SPACE_UPDATE=y
CONFIG_BT_CTLR_FRAME_SPACE_UPDATE=y
CONFIG_BT_CTLR_FSU_MIN_FRAME_SPACE_US=80

# Test-only: expose the per-connection scheduler slot reservation
# (ll_test_conn_ticks_slot[]) so central_fsu can prove the reservation shrinks
# when the negotiated inter-frame space shortens (150 -> 80 us) -- FSU's value.
CONFIG_BT_CTLR_TEST_CONN_TICKS_SLOT=y
```

## overlay-sci-iso.conf
```kconfig
# Overlay STACKED on overlay-sci.conf (pass both to OVERLAY_CONFIG). It
# co-enables the Connected ISO (CIS) and Periodic Advertising Sync Transfer
# (PAST) controller code alongside SCI, so the ECV-reject guards added to those
# paths are COMPILED in CI with CONFIG_BT_CTLR_SHORTER_CONNECTION_INTERVALS on
# and do not silently bit-rot. Guard sites kept on the compile path:
#   - ll_cis_create_check        (ull_central_iso.c, CENTRAL_ISO)
#   - rp_cc_st_idle CIS_REQ       (ull_llcp_cc.c,     PERIPHERAL_ISO)
#   - ull_cp_periodic_sync        (ull_llcp.c,        SYNC_TRANSFER_SENDER)
#   - PAST receive handler        (ull_sync.c,        SYNC_TRANSFER_RECEIVER)
#
# Build-only: the conn_subrate app does not exercise ISO/PAST at runtime. The
# ECV floor's reduced-reservation timing assumes BT_CTLR_ADV_EXT=n; PAST forces
# EXT_ADV on, which changes the event-overhead regime -- irrelevant to a compile
# check, which is all this overlay is for. The runtime ECV scenarios run under
# overlay-sci.conf (no EXT_ADV) in the other steps.

# --- Connected ISO (CIS): central + peripheral controller roles ---
CONFIG_BT_ISO_CENTRAL=y
CONFIG_BT_ISO_PERIPHERAL=y
CONFIG_BT_CTLR_CENTRAL_ISO=y
CONFIG_BT_CTLR_PERIPHERAL_ISO=y
CONFIG_BT_CTLR_ISO_TX_BUFFER_SIZE=208
CONFIG_BT_CTLR_ISO_TX_SDU_LEN_MAX=200
CONFIG_BT_CTLR_ISO_TX_BUFFERS=4
CONFIG_BT_CTLR_ISOAL_SOURCES=2
CONFIG_BT_CTLR_ISOAL_SINKS=2
CONFIG_BT_CTLR_CONN_ISO_STREAMS_PER_GROUP=4

# --- Periodic Advertising Sync Transfer (PAST): sender + receiver ---
CONFIG_BT_EXT_ADV=y
CONFIG_BT_PER_ADV=y
CONFIG_BT_OBSERVER=y
CONFIG_BT_PER_ADV_SYNC=y
CONFIG_BT_PER_ADV_SYNC_TRANSFER_RECEIVER=y
CONFIG_BT_PER_ADV_SYNC_TRANSFER_SENDER=y
```

## src/main.c
```c
/*
 * Copyright (c) 2026 The ZMK Contributors
 *
 * SPDX-License-Identifier: Apache-2.0
 */

#include "bstests.h"

extern struct bst_test_list *test_central_install(struct bst_test_list *tests);
extern struct bst_test_list *test_peripheral_install(struct bst_test_list *tests);

bst_test_install_t test_installers[] = {
	test_central_install,
	test_peripheral_install,
	NULL
};

int main(void)
{
	bst_main();
	return 0;
}
```

## src/conn_subrate.h
```c
/*
 * Copyright (c) 2026 The ZMK Contributors
 *
 * SPDX-License-Identifier: Apache-2.0
 *
 * Shared parameters for the conn_subrate bsim test.
 */
#ifndef CONN_SUBRATE_H_
#define CONN_SUBRATE_H_

/* Fixed connection parameters used by the central when creating the link, so
 * the subrate skip cadence is deterministic. The interval is set at connection
 * setup (no separate update procedure) to avoid resetting subrating.
 */
#define CONN_INTERVAL_UNITS 24U  /* 30 ms (1.25 ms units) */
#define CONN_TIMEOUT_UNITS  200U /* 2 s (10 ms units) */

/* Peripheral-initiated Connection Subrate Request parameters (5.1.20). A range
 * is requested so the central can grant the largest factor it accepts.
 */
#define SUBRATE_REQ_MIN          2U
#define SUBRATE_REQ_MAX          8U
#define SUBRATE_REQ_MAX_LATENCY  0U
#define SUBRATE_REQ_CONT_NUMBER  0U
#define SUBRATE_REQ_TIMEOUT      CONN_TIMEOUT_UNITS

/* Central acceptable subrate defaults (must allow the request above). */
#define SUBRATE_ACC_MAX 8U

/* M->N transition test: the Peripheral first negotiates SUBRATE_MTON_M, then the
 * Central re-negotiates to SUBRATE_MTON_N (both > 1 -> a true M->N transition).
 */
#define SUBRATE_MTON_M 4U
#define SUBRATE_MTON_N 8U

/* Non-power-of-2 factor: the subrated-event phase math must be correct when the
 * factor does not divide the 16-bit event counter (an unsigned (event - base) %
 * factor mis-anchors for these). Reuses the basic `central` skip probe.
 */
#define SUBRATE_ODD_FACTOR 5U

/* Supervision-timeout boundary: the largest factor the HCI bound allows here
 * (interval[1.25ms]*factor*(lat+1) < 2x supervision: 24*33 = 792 < 800). Its
 * skip period (~990 ms) is just under half the 2 s supervision timeout, so an
 * idle link survives only if the peripheral keeps listening on subrated events.
 */
#define SUBRATE_SUPERVISION_FACTOR 33U

/* conn-update test: the Central changes the interval while subrated, which must
 * reset subrating to factor 1. A different value from CONN_INTERVAL_UNITS so the
 * interval actually changes.
 */
#define CONN_UPDATE_INTERVAL_UNITS 36U /* 45 ms */

/* Continuation-events test: factor with a large continuation_number so that,
 * after data activity, both sides stay present for ~the whole subrate cycle.
 * Close-spaced reads (< CONT_WINDOW) stay fast; the first idle read is slow.
 */
#define SUBRATE_CONT_FACTOR 8U
#define SUBRATE_CONT_CN     7U  /* factor - 1 */
#define CONT_READ_GAP_MS    50  /* < CN*interval (210 ms) -> within window */
#define CONT_IDLE_MS        600 /* > skip period -> peripheral re-skips first */

/* Peripheral-latency test: the Peripheral stacks max_latency on top of the
 * factor, skipping factor*(latency+1) events while the Central stays on every
 * factor-th subrated event; they still rendezvous.
 */
#define SUBRATE_LAT_FACTOR  4U
#define SUBRATE_LAT_LATENCY 2U  /* effective skip = 4*(2+1) = 12 events */

/* Central-cadence regression lock (reuses peripheral_latency). With the
 * Peripheral coasting on its stacked max_latency, the Central must stay present
 * only on its own subrated events (every factor). A controller that breaks
 * latency on the Peripheral's expected skipped events collapses the Central to
 * ~full rate; counting the Central's events over an idle window catches that.
 * Window spans several stacked cycles (factor*(latency+1)*interval = 360 ms).
 */
#define LAT_COUNT_WINDOW_MS 3000

/* Collision test: both sides request a subrate change at the same time. */
#define SUBRATE_COLL_INITIAL 4U /* peripheral negotiates this first */
#define SUBRATE_COLL_CENTRAL 8U /* central's colliding request */
#define SUBRATE_COLL_PERIPH  2U /* peripheral's colliding request */
#define COLLISION_TIME_MS    3000 /* both fire at this uptime */

/* Central->Peripheral continuation test: a write-without-response characteristic
 * the Central bursts data to. Write-without-response is one-way (no GATT
 * response), so only the Central's own Tx can open its continuation window -
 * this isolates that path. With it working the burst arrives at ~the event
 * rate; otherwise it is throttled to the subrate cadence (factor x fewer).
 */
#define CWRITE_SVC_UUID \
	BT_UUID_128_ENCODE(0x5ab12701, 0x1234, 0x4c0d, 0x9e1a, 0xc0ffee000001)
#define CWRITE_CHR_UUID \
	BT_UUID_128_ENCODE(0x5ab12702, 0x1234, 0x4c0d, 0x9e1a, 0xc0ffee000002)

/* One-way latency test: a notify characteristic whose payload is the
 * peripheral's send timestamp (uint32 us). The Central subscribes and, on each
 * notification, computes recv_us - sent_us -- the one-way notification latency
 * (the faithful HID-input direction), measurable because bsim runs both devices
 * on one global simulated clock (k_uptime is shared, cf. the collision test).
 */
#define LAT_SVC_UUID \
	BT_UUID_128_ENCODE(0x5ab12703, 0x1234, 0x4c0d, 0x9e1a, 0xc0ffee000003)
#define LAT_CHR_UUID \
	BT_UUID_128_ENCODE(0x5ab12704, 0x1234, 0x4c0d, 0x9e1a, 0xc0ffee000004)
#define LAT_NOTIFY_COUNT   60   /* notifications to sample */
#define LAT_NOTIFY_GAP_MS  20   /* spacing -> each lands fresh on the link */

/* Notifications-under-subrating: notify slower than the skip period (factor *
 * interval = 240 ms at factor 8) so each notification is queued during a skip
 * and must wake the peripheral on a subrated event to be delivered - rather
 * than a fast stream that keeps the link awake and never really subrates.
 */
#define SUBRATE_NOTIFY_PERIOD_MS 400

/* Time the peripheral waits after connecting before requesting subrating, to
 * let feature exchange and the central's discovery complete first.
 */
#define SETTLE_DELAY_MS 1000

/* Central read probe: number of reads and the idle gap between them. The gap
 * must exceed the subrate skip period (factor * interval) so the peripheral has
 * gone back to sleep before each probe.
 */
#define NUM_READS    8
#define READ_GAP_MS  400

#endif /* CONN_SUBRATE_H_ */
```

## src/peripheral.c
```c
/*
 * Copyright (c) 2026 The ZMK Contributors
 *
 * SPDX-License-Identifier: Apache-2.0
 *
 * Subrating peripheral. Advertise, accept a connection, then initiate a
 * Connection Subrate Request (Core Spec 5.1.20). The Central observes the
 * resulting event skipping and drives the assertions; the peripheral mostly
 * negotiates the requested parameters and stays alive.
 */
#include <zephyr/kernel.h>

#include "bs_types.h"
#include "bs_tracing.h"
#include "time_machine.h"
#include "bstests.h"

#include <zephyr/types.h>
#include <stddef.h>
#include <errno.h>
#include <zephyr/sys/printk.h>

#include <zephyr/bluetooth/bluetooth.h>
#include <zephyr/bluetooth/hci.h>
#include <zephyr/bluetooth/conn.h>
#include <zephyr/bluetooth/gatt.h>
#include <zephyr/bluetooth/uuid.h>
#include <zephyr/bluetooth/services/hrs.h>
#include <zephyr/sys/byteorder.h>

#include "conn_subrate.h"

#define WAIT_TIME 30 /* seconds */

extern enum bst_result_t bst_result;

#define FAIL(...)					\
	do {						\
		bst_result = Failed;			\
		bs_trace_error_time_line(__VA_ARGS__);	\
	} while (0)

#define PASS(...)					\
	do {						\
		bst_result = Passed;			\
		bs_trace_info_time(1, __VA_ARGS__);	\
	} while (0)

static struct bt_conn *default_conn;
static volatile bool connected_flag;
/* In the collision scenario both sides re-negotiate simultaneously; one request
 * may be rejected (a valid LLCP collision outcome) and the survival check, not
 * the subrate_changed callback, decides pass/fail.
 */
static volatile bool collision_mode;

static const struct bt_data ad[] = {
	BT_DATA_BYTES(BT_DATA_FLAGS, (BT_LE_AD_GENERAL | BT_LE_AD_NO_BREDR)),
	BT_DATA(BT_DATA_NAME_COMPLETE, CONFIG_BT_DEVICE_NAME,
		sizeof(CONFIG_BT_DEVICE_NAME) - 1),
};

/* Write-without-response characteristic for the central->peripheral
 * continuation test; each write the Central sends increments the counter.
 */
static volatile int cwrite_count;

static ssize_t cwrite_cb(struct bt_conn *conn, const struct bt_gatt_attr *attr,
			 const void *buf, uint16_t len, uint16_t offset, uint8_t flags)
{
	ARG_UNUSED(conn);
	ARG_UNUSED(attr);
	ARG_UNUSED(buf);
	ARG_UNUSED(offset);
	ARG_UNUSED(flags);
	cwrite_count++;
	return len;
}

BT_GATT_SERVICE_DEFINE(cwrite_svc,
	BT_GATT_PRIMARY_SERVICE(BT_UUID_DECLARE_128(CWRITE_SVC_UUID)),
	BT_GATT_CHARACTERISTIC(BT_UUID_DECLARE_128(CWRITE_CHR_UUID),
			       BT_GATT_CHRC_WRITE_WITHOUT_RESP, BT_GATT_PERM_WRITE,
			       NULL, cwrite_cb, NULL));

/* Notify characteristic carrying the peripheral's send timestamp (uint32 us)
 * for the one-way latency test. attrs[2] is the value attribute.
 */
static void lat_ccc_changed(const struct bt_gatt_attr *attr, uint16_t value)
{
	ARG_UNUSED(attr);
	ARG_UNUSED(value);
}

BT_GATT_SERVICE_DEFINE(lat_svc,
	BT_GATT_PRIMARY_SERVICE(BT_UUID_DECLARE_128(LAT_SVC_UUID)),
	BT_GATT_CHARACTERISTIC(BT_UUID_DECLARE_128(LAT_CHR_UUID),
			       BT_GATT_CHRC_NOTIFY, BT_GATT_PERM_NONE, NULL, NULL, NULL),
	BT_GATT_CCC(lat_ccc_changed, BT_GATT_PERM_READ | BT_GATT_PERM_WRITE));

#if defined(CONFIG_BT_SHORTER_CONNECTION_INTERVALS)
/* ZMK-split pointing-load characteristic: the peripheral streams one 8-byte
 * input-event payload per connection interval on it, modelling a streaming
 * trackpad on the ZMK split link (see ECV_LOAD_SVC_UUID in conn_subrate.h for
 * the payload/wire-size accounting; a real paired link adds a 4-byte MIC).
 * attrs[2] is the value attribute (cf. lat_svc). Streaming is gated on the
 * central's CCC subscribe (like a real ZMK central) so bt_gatt_notify never
 * runs against a disabled CCC and the failure counter stays meaningful.
 */
static volatile bool load_ccc_enabled;

static void load_ccc_changed(const struct bt_gatt_attr *attr, uint16_t value)
{
	ARG_UNUSED(attr);
	load_ccc_enabled = (value == BT_GATT_CCC_NOTIFY);
}

BT_GATT_SERVICE_DEFINE(load_svc,
	BT_GATT_PRIMARY_SERVICE(BT_UUID_DECLARE_128(ECV_LOAD_SVC_UUID)),
	BT_GATT_CHARACTERISTIC(BT_UUID_DECLARE_128(ECV_LOAD_CHR_UUID),
			       BT_GATT_CHRC_NOTIFY, BT_GATT_PERM_NONE, NULL, NULL, NULL),
	BT_GATT_CCC(load_ccc_changed, BT_GATT_PERM_READ | BT_GATT_PERM_WRITE));
#endif /* CONFIG_BT_SHORTER_CONNECTION_INTERVALS */

static void subrate_changed(struct bt_conn *conn,
			    const struct bt_conn_le_subrate_changed *params)
{
	printk("Peripheral subrate changed: status %u factor %u cont %u "
	       "latency %u timeout %u\n", params->status, params->factor,
	       params->continuation_number, params->peripheral_latency,
	       params->supervision_timeout);

	if (params->status != BT_HCI_ERR_SUCCESS) {
		if (collision_mode) {
			/* A rejected request is an acceptable collision outcome. */
			return;
		}
		FAIL("Peripheral subrate change failed (status 0x%02x)\n",
		     params->status);
		return;
	}

	/* Negotiation succeeded; the Central validates the resulting skipping. */
	if (!collision_mode && params->factor >= 2U) {
		PASS("Peripheral subrating active (factor %u)\n", params->factor);
	}
}

static void connected(struct bt_conn *conn, uint8_t err)
{
	if (err) {
		FAIL("Peripheral failed to connect (err 0x%02x)\n", err);
		return;
	}

	default_conn = bt_conn_ref(conn);
	connected_flag = true;
	printk("Peripheral connected\n");
}

static void disconnected(struct bt_conn *conn, uint8_t reason)
{
	printk("Peripheral disconnected (reason 0x%02x)\n", reason);

	if (default_conn) {
		bt_conn_unref(default_conn);
		default_conn = NULL;
	}
	connected_flag = false;
}

static struct bt_conn_cb conn_callbacks = {
	.connected = connected,
	.disconnected = disconnected,
	.subrate_changed = subrate_changed,
};

static int peripheral_setup(void)
{
	int err;

	bt_conn_cb_register(&conn_callbacks);

	err = bt_enable(NULL);
	if (err) {
		FAIL("Bluetooth init failed (err %d)\n", err);
		return err;
	}

	printk("Peripheral Bluetooth initialized\n");

	err = bt_le_adv_start(BT_LE_ADV_CONN_FAST_1, ad, ARRAY_SIZE(ad), NULL, 0);
	if (err) {
		FAIL("Advertising failed to start (err %d)\n", err);
		return err;
	}

	printk("Peripheral advertising started\n");
	return 0;
}

static int periph_request_subrate(uint16_t subrate_min, uint16_t subrate_max,
				  uint16_t max_latency, uint16_t cont_number)
{
	struct bt_conn_le_subrate_param param = {
		.subrate_min = subrate_min,
		.subrate_max = subrate_max,
		.max_latency = max_latency,
		.continuation_number = cont_number,
		.supervision_timeout = SUBRATE_REQ_TIMEOUT,
	};
	int err = bt_conn_le_subrate_request(default_conn, &param);

	if (err) {
		FAIL("Peripheral subrate request failed (err %d)\n", err);
		return err;
	}
	printk("Peripheral requested subrating (min %u max %u lat %u cn %u)\n",
	       subrate_min, subrate_max, max_latency, cont_number);
	return 0;
}

/* Advertise, once connected and settled request subrating with the given
 * parameters, then stay alive responding to whatever the Central drives next.
 */
static void peripheral_run(uint16_t subrate_min, uint16_t subrate_max,
			   uint16_t max_latency, uint16_t cont_number)
{
	bool requested = false;

	if (peripheral_setup()) {
		return;
	}

	while (true) {
		k_sleep(K_MSEC(SETTLE_DELAY_MS));

		if (connected_flag && !requested && default_conn) {
			requested = true;
			if (periph_request_subrate(subrate_min, subrate_max,
						   max_latency, cont_number)) {
				return;
			}
		}
	}
}

static void test_peripheral_main(void)
{
	peripheral_run(SUBRATE_REQ_MIN, SUBRATE_REQ_MAX, 0U, 0U);
}

static void test_peripheral_main_transitions(void)
{
	/* Negotiate exactly factor M; the Central re-negotiates to N afterwards. */
	peripheral_run(SUBRATE_MTON_M, SUBRATE_MTON_M, 0U, 0U);
}

static void test_peripheral_main_continuation(void)
{
	peripheral_run(SUBRATE_CONT_FACTOR, SUBRATE_CONT_FACTOR, 0U, SUBRATE_CONT_CN);
}

static void test_peripheral_main_oddfactor(void)
{
	peripheral_run(SUBRATE_ODD_FACTOR, SUBRATE_ODD_FACTOR, 0U, 0U);
}

static void test_peripheral_main_supervision(void)
{
	peripheral_run(SUBRATE_SUPERVISION_FACTOR, SUBRATE_SUPERVISION_FACTOR, 0U, 0U);
}

static void test_peripheral_main_plain(void)
{
	if (peripheral_setup()) {
		return;
	}
	/* Full-rate peer for the multi-connection test: connect and idle, never
	 * request subrating. Mark pass once connected (the central drives and
	 * validates the cadence); unlike the subrating peers there is no
	 * subrate_changed to pass on. Then stay alive for the rest of the sim.
	 */
	while (!connected_flag) {
		k_sleep(K_MSEC(50));
	}
	PASS("Peripheral (plain) connected; full-rate peer\n");
	while (true) {
		k_sleep(K_MSEC(SETTLE_DELAY_MS));
	}
}

static void test_peripheral_main_cwrite(void)
{
	int before;

	if (peripheral_setup()) {
		return;
	}

	while (!connected_flag) {
		k_sleep(K_MSEC(50));
		if (bst_result == Failed) {
			return;
		}
	}
	k_sleep(K_MSEC(SETTLE_DELAY_MS));

	/* Subrate with continuation enabled, then count the Central's bursts. */
	if (periph_request_subrate(SUBRATE_CONT_FACTOR, SUBRATE_CONT_FACTOR, 0U,
				   SUBRATE_CONT_CN)) {
		return;
	}

	/* Let the Central discover the characteristic and start writing. */
	k_sleep(K_SECONDS(2));
	before = cwrite_count;
	k_sleep(K_SECONDS(3));
	printk("Peripheral received %d central writes under subrating\n",
	       cwrite_count - before);

	/* With the Central's own Tx opening the continuation window the burst
	 * arrives near the event rate (~100 in 3 s); throttled to the subrate
	 * cadence it would be ~factor times fewer (~12). Require well above that.
	 */
	if ((cwrite_count - before) < 30) {
		FAIL("Too few central writes under continuation: %d\n",
		     cwrite_count - before);
		return;
	}
	PASS("Peripheral C->P continuation validated (%d writes in 3 s)\n",
	     cwrite_count - before);
}

static void test_peripheral_main_latency(void)
{
	peripheral_run(SUBRATE_LAT_FACTOR, SUBRATE_LAT_FACTOR, SUBRATE_LAT_LATENCY, 0U);
}

static void test_peripheral_main_collision(void)
{
	if (peripheral_setup()) {
		return;
	}

	while (!connected_flag) {
		k_sleep(K_MSEC(50));
		if (bst_result == Failed) {
			return;
		}
	}
	k_sleep(K_MSEC(SETTLE_DELAY_MS));

	/* Establish subrating first. */
	if (periph_request_subrate(SUBRATE_COLL_INITIAL, SUBRATE_COLL_INITIAL, 0U, 0U)) {
		return;
	}

	/* Both sides re-negotiate at the same uptime to force an LLCP collision. */
	while (k_uptime_get() < COLLISION_TIME_MS) {
		k_sleep(K_MSEC(20));
	}
	collision_mode = true;
	(void)periph_request_subrate(SUBRATE_COLL_PERIPH, SUBRATE_COLL_PERIPH, 0U, 0U);

	/* Survive the collision: still connected a while later. Check before the
	 * central's end-of-test disconnect (it sleeps longer post-collision).
	 */
	k_sleep(K_MSEC(2000));
	if (!connected_flag) {
		FAIL("Peripheral lost connection after subrate collision\n");
		return;
	}
	PASS("Peripheral survived subrate collision\n");
}

/* Peer side of central_sci_collision: drive a Connection Parameters Request at
 * the same uptime the Central drives its Connection Rate Update, so two instant
 * procedures collide. The link must survive (no instant desync).
 */
static void test_peripheral_main_sci_collision(void)
{
	struct bt_le_conn_param *upd = BT_LE_CONN_PARAM(CONN_UPDATE_INTERVAL_UNITS,
							CONN_UPDATE_INTERVAL_UNITS,
							0, CONN_TIMEOUT_UNITS);

	if (peripheral_setup()) {
		return;
	}

	while (!connected_flag) {
		k_sleep(K_MSEC(50));
		if (bst_result == Failed) {
			return;
		}
	}
	k_sleep(K_MSEC(SETTLE_DELAY_MS));

	while (k_uptime_get() < COLLISION_TIME_MS) {
		k_sleep(K_MSEC(20));
	}
	collision_mode = true;
	(void)bt_conn_le_param_update(default_conn, upd);

	k_sleep(K_MSEC(3000));
	if (!connected_flag) {
		FAIL("Peripheral lost the link after the SCI/conn-update collision\n");
		return;
	}
	PASS("Peripheral survived SCI/conn-update collision\n");
}

/* Peer side of central_sci_latency: stream the send timestamp on the latency
 * characteristic. The Central drives the SCI rate, subscribes, and measures the
 * one-way delay. Notifications before the Central subscribes simply no-op.
 */
static void test_peripheral_main_sci_latency(void)
{
	if (peripheral_setup()) {
		return;
	}

	while (!connected_flag) {
		k_sleep(K_MSEC(50));
		if (bst_result == Failed) {
			return;
		}
	}

	for (int i = 0; i < 400 && connected_flag; i++) {
		uint32_t sent_us = (uint32_t)k_ticks_to_us_floor64(k_uptime_ticks());
		uint8_t buf[sizeof(sent_us)];

		sys_put_le32(sent_us, buf);
		(void)bt_gatt_notify(default_conn, &lat_svc.attrs[2], buf, sizeof(buf));
		k_sleep(K_MSEC(LAT_NOTIFY_GAP_MS));
	}

	PASS("Peripheral streamed latency notifications\n");
}

#if defined(CONFIG_BT_SHORTER_CONNECTION_INTERVALS)
/* Peer side of the central_ecv_* load cells: once the Central has driven the
 * link to its target ECV interval (learned from the conn_rate_changed event's
 * interval_us), stream exactly one 8-byte ZMK input-event notification per
 * connection interval, paced by a k_timer at the interval period -- a
 * streaming trackpad on the split link. The payload mirrors ZMK's
 * zmk_split_input_event_payload {u8 type, u16 code, u32 value, u8 sync}
 * (type = 2/EV_REL, code = 0/REL_X, sync = 1) with the sequence number in
 * `value` so the Central can count delivery gaps. The sequence advances ONLY
 * on a successful queue: a send failure (e.g. -ENOMEM under backpressure)
 * shows up at the Central as a rate shortfall, not as a fake gap, so gaps mean
 * genuine loss. The Central holds all the assertions; this side PASSes on the
 * first successful send and keeps streaming (so one testid serves the gate,
 * control, and probe cells alike -- on a probe the link may die under it,
 * which is the Central's data, not this side's failure).
 */
static volatile uint32_t load_interval_us;

static void load_conn_rate_changed(struct bt_conn *conn, uint8_t status,
				   const struct bt_conn_le_conn_rate_changed *params)
{
	ARG_UNUSED(conn);

	if (status == BT_HCI_ERR_SUCCESS && params != NULL) {
		load_interval_us = params->interval_us;
	}
	printk("Peripheral conn rate changed: status 0x%02x interval %u us\n",
	       status, params != NULL ? params->interval_us : 0U);
}

static struct bt_conn_cb load_rate_callbacks = {
	.conn_rate_changed = load_conn_rate_changed,
};

/* Semaphore depth 8: a small backlog survives a busy host thread; beyond that
 * ticks collapse and the Central sees the rate shortfall (the intended signal).
 */
static K_SEM_DEFINE(load_tick_sem, 0, 8);

static void load_timer_fn(struct k_timer *timer)
{
	ARG_UNUSED(timer);
	k_sem_give(&load_tick_sem);
}

static K_TIMER_DEFINE(load_timer, load_timer_fn, NULL);

static void test_peripheral_main_zmk_load(void)
{
	uint32_t seq = 0U, sent = 0U, failed = 0U, us;
	bool passed = false;

	bt_conn_cb_register(&load_rate_callbacks);

	if (peripheral_setup()) {
		return;
	}

	while (!connected_flag) {
		k_sleep(K_MSEC(50));
		if (bst_result == Failed) {
			return;
		}
	}

	/* Wait for the Central to drive the link to its sub-7.5 ms target AND
	 * enable notifications (either order): input only flows on a subscribed
	 * characteristic, as on a real ZMK split link. A link lost while waiting
	 * is recorded, not failed: the central owns every cell's verdict (on a
	 * gate cell it FAILs the run; on a probe it is the recorded floor datum).
	 */
	while (load_interval_us == 0U || load_interval_us >= 7500U ||
	       !load_ccc_enabled) {
		k_sleep(K_MSEC(50));
		if (bst_result == Failed) {
			return;
		}
		if (!connected_flag) {
			PASS("Peripheral ZMK-load: link lost before streaming began "
			     "(central records the outcome)\n");
			while (true) {
				k_sleep(K_MSEC(SETTLE_DELAY_MS));
			}
		}
	}
	us = load_interval_us;
	printk("Peripheral ZMK-load: streaming 1 x 8-byte input event per %u us CE\n",
	       us);

	/* K_USEC ceil-rounds to system ticks (30.5 us at 32768 Hz), so the
	 * generator runs at most ~1 tick slow per period -- accounted for in the
	 * Central's 90% rate floor (see conn_subrate.h).
	 */
	k_timer_start(&load_timer, K_USEC(us), K_USEC(us));

	while (connected_flag && bst_result != Failed) {
		uint8_t payload[8];
		int err;

		if (k_sem_take(&load_tick_sem, K_MSEC(1000)) != 0) {
			continue; /* re-check connected_flag */
		}

		/* zmk_split_input_event_payload, built LE-explicit. */
		payload[0] = 0x02U;              /* type: EV_REL */
		sys_put_le16(0x0000U, &payload[1]); /* code: REL_X */
		sys_put_le32(seq, &payload[3]);  /* value: sequence number */
		payload[7] = 0x01U;              /* sync */

		err = bt_gatt_notify(default_conn, &load_svc.attrs[2], payload,
				     sizeof(payload));
		if (err == 0) {
			seq++;
			sent++;
			if (!passed) {
				passed = true;
				PASS("Peripheral ZMK-load streaming at %u us\n", us);
			}
		} else {
			failed++;
			if (failed <= 5U) {
				printk("Peripheral ZMK-load notify failed (err %d, "
				       "%u so far)\n", err, failed);
			}
		}
	}

	k_timer_stop(&load_timer);
	printk("Peripheral ZMK-load final: sent %u, failed %u (interval %u us)\n",
	       sent, failed, us);
	if (!passed) {
		/* Not one notification queued before the link went down: the
		 * central records/asserts this per its cell mode.
		 */
		PASS("Peripheral ZMK-load: link died before any send succeeded "
		     "(central records the outcome)\n");
	}

	/* Stay alive for the rest of the simulation (cf. peripheral_plain). */
	while (true) {
		k_sleep(K_MSEC(SETTLE_DELAY_MS));
	}
}
#endif /* CONFIG_BT_SHORTER_CONNECTION_INTERVALS */

static void test_peripheral_main_notify(void)
{
	uint16_t heartrate = 90U;
	bool requested = false;

	if (peripheral_setup()) {
		return;
	}

	/* Request subrating once connected+settled, then stream HRS notifications.
	 * Under subrating the controller can only send them on subrated/continuation
	 * events; the Central verifies they still flow.
	 */
	while (true) {
		k_sleep(K_MSEC(SUBRATE_NOTIFY_PERIOD_MS));

		if (connected_flag && !requested && default_conn) {
			requested = true;
			if (periph_request_subrate(SUBRATE_REQ_MIN, SUBRATE_REQ_MAX, 0U, 0U)) {
				return;
			}
		}

		if (connected_flag) {
			(void)bt_hrs_notify(heartrate);
			if (++heartrate > 160U) {
				heartrate = 90U;
			}
		}
	}
}

static void test_peripheral_init(void)
{
	bst_ticker_set_next_tick_absolute(WAIT_TIME * 1e6);
	bst_result = In_progress;
}

static void test_peripheral_tick(bs_time_t HW_device_time)
{
	if (bst_result != Passed) {
		FAIL("peripheral failed (not passed after %i seconds)\n", WAIT_TIME);
	}
}

static const struct bst_test_instance test_peripheral[] = {
	{
		.test_id = "peripheral",
		.test_descr = "Peripheral: requests subrating (factor > 1).",
		.test_pre_init_f = test_peripheral_init,
		.test_tick_f = test_peripheral_tick,
		.test_main_f = test_peripheral_main,
	},
	{
		.test_id = "peripheral_transitions",
		.test_descr = "Peripheral: negotiates factor M; Central re-negotiates "
			      "to N and changes the interval.",
		.test_pre_init_f = test_peripheral_init,
		.test_tick_f = test_peripheral_tick,
		.test_main_f = test_peripheral_main_transitions,
	},
	{
		.test_id = "peripheral_continuation",
		.test_descr = "Peripheral: subrating with continuation_number > 0.",
		.test_pre_init_f = test_peripheral_init,
		.test_tick_f = test_peripheral_tick,
		.test_main_f = test_peripheral_main_continuation,
	},
	{
		.test_id = "peripheral_latency",
		.test_descr = "Peripheral: subrating with peripheral latency > 0.",
		.test_pre_init_f = test_peripheral_init,
		.test_tick_f = test_peripheral_tick,
		.test_main_f = test_peripheral_main_latency,
	},
	{
		.test_id = "peripheral_collision",
		.test_descr = "Peripheral: re-negotiates subrating simultaneously with "
			      "the Central (LLCP collision); link must survive.",
		.test_pre_init_f = test_peripheral_init,
		.test_tick_f = test_peripheral_tick,
		.test_main_f = test_peripheral_main_collision,
	},
	{
		.test_id = "peripheral_sci_collision",
		.test_descr = "Peripheral: drives a Connection Parameters Request "
			      "simultaneously with the Central's Connection Rate Update "
			      "(two instants collide); link must survive.",
		.test_pre_init_f = test_peripheral_init,
		.test_tick_f = test_peripheral_tick,
		.test_main_f = test_peripheral_main_sci_collision,
	},
	{
		.test_id = "peripheral_sci_latency",
		.test_descr = "Peripheral: streams send-timestamp notifications for the "
			      "Central's one-way latency measurement.",
		.test_pre_init_f = test_peripheral_init,
		.test_tick_f = test_peripheral_tick,
		.test_main_f = test_peripheral_main_sci_latency,
	},
	{
		.test_id = "peripheral_notify",
		.test_descr = "Peripheral: streams HRS notifications while subrated.",
		.test_pre_init_f = test_peripheral_init,
		.test_tick_f = test_peripheral_tick,
		.test_main_f = test_peripheral_main_notify,
	},
	{
		.test_id = "peripheral_oddfactor",
		.test_descr = "Peripheral: negotiates a non-power-of-2 factor (5).",
		.test_pre_init_f = test_peripheral_init,
		.test_tick_f = test_peripheral_tick,
		.test_main_f = test_peripheral_main_oddfactor,
	},
	{
		.test_id = "peripheral_supervision",
		.test_descr = "Peripheral: large factor near the supervision-timeout bound.",
		.test_pre_init_f = test_peripheral_init,
		.test_tick_f = test_peripheral_tick,
		.test_main_f = test_peripheral_main_supervision,
	},
	{
		.test_id = "peripheral_cwrite",
		.test_descr = "Peripheral: counts the Central's write-without-response "
			      "burst under continuation.",
		.test_pre_init_f = test_peripheral_init,
		.test_tick_f = test_peripheral_tick,
		.test_main_f = test_peripheral_main_cwrite,
	},
	{
		.test_id = "peripheral_plain",
		.test_descr = "Peripheral: connects and idles, never requests subrating "
			      "(full-rate peer for the multi-connection test).",
		.test_pre_init_f = test_peripheral_init,
		.test_tick_f = test_peripheral_tick,
		.test_main_f = test_peripheral_main_plain,
	},
#if defined(CONFIG_BT_SHORTER_CONNECTION_INTERVALS)
	{
		.test_id = "peripheral_zmk_load",
		.test_descr = "Peripheral: streams one 8-byte ZMK input-event "
			      "notification per connection interval once the Central "
			      "drives the link to its ECV target (the ZMK-split "
			      "pointing load for the central_ecv_* load cells).",
		.test_pre_init_f = test_peripheral_init,
		.test_tick_f = test_peripheral_tick,
		.test_main_f = test_peripheral_main_zmk_load,
	},
#endif
	BSTEST_END_MARKER,
};

struct bst_test_list *test_peripheral_install(struct bst_test_list *tests)
{
	return bst_add_tests(tests, test_peripheral);
}
```
