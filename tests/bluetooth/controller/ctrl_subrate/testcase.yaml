## tests/bluetooth/controller/ctrl_subrate/testcase.yaml
```yaml
common:
  tags:
    - bluetooth
    - bt_subrating
    - bt_ull_llcp
tests:
  bluetooth.controller.ctrl_subrate.test:
    type: unit
```
