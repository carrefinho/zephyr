## drivers/clock_control/Kconfig.wch_rcc
```kconfig
# Copyright (c) 2024 Michael Hope
# SPDX-License-Identifier: Apache-2.0

config CLOCK_CONTROL_WCH_RCC
	bool "WCH CH32V00x Reset and Clock Control (RCC) driver"
	default y
	depends on DT_HAS_WCH_RCC_ENABLED

config CLOCK_CONTROL_WCH_RCC_SINGLE_SOURCE
	bool
	default y if SOC_CH32X035
	depends on CLOCK_CONTROL_WCH_RCC
	help
	  Selected on SoCs with exactly one system clock source (no HSE, no
	  PLL), where RCC_CFGR0 has no SW/SWS select field and RCC_CTLR has no
	  clock-security enable. On the CH32X035 CFGR0 holds only MCO and HPRE
	  (RM V1.9 §3.4.2), so there is no source to select and nothing for the
	  CSS to monitor.

config CLOCK_CONTROL_WCH_RCC_NO_LSI_CONTROL
	bool
	default y if SOC_CH32X035
	depends on CLOCK_CONTROL_WCH_RCC
	help
	  Selected on SoCs whose RCC_RSTSCKR has no LSION/LSIRDY bits, i.e. the
	  LSI has no software enable and is always available (it only feeds the
	  IWDG/AWU). On the CH32X035 that whole register's low half-word is
	  reserved (RM V1.9 §3.4.8) and the vendor StdPeriph tree has no LSI
	  enable function at all, so enabling and then spin-waiting for a ready
	  bit that never sets hangs the boot.
```

## drivers/display/Kconfig.ssd1362
```kconfig
# Copyright (c) 2025 MASSDRIVER EI (massdriver.space)
# SPDX-License-Identifier: Apache-2.0

config SSD1362
	bool "SSD1362 display driver"
	default y
	depends on DT_HAS_SOLOMON_SSD1362_ENABLED
	select MIPI_DBI
	help
	  Enable driver for SSD1362 display driver.

if SSD1362

config SSD1362_DEFAULT_CONTRAST
	int "SSD1362 default contrast"
	default 159
	range 0 255
	help
	  SSD1362 default contrast setting (0x9F = 159).

config SSD1362_CONV_BUFFER_LINES
	int "Number of lines the conversion buffer can hold"
	default 16
	range 1 64
	help
	  Number of lines to convert at once. Higher values use more memory
	  but may improve performance by reducing the number of transfers.

endif # SSD1362
```

## drivers/pinctrl/Kconfig.wch_x03x_afio
```kconfig
# Copyright (c) 2026 The ZMK Contributors
# SPDX-License-Identifier: Apache-2.0

config PINCTRL_WCH_X03X_AFIO
	bool "WCH AFIO pin controller driver for CH32X035"
	default y
	depends on DT_HAS_WCH_X03X_AFIO_ENABLED
	help
	  WCH CH32X03x AFIO pin controller driver (single PCFR1 remap register).
```

## dts/bindings/display/solomon,ssd1362.yaml
```yaml
# Copyright (c) 2025 MASSDRIVER EI (massdriver.space)
# SPDX-License-Identifier: Apache-2.0

title: Solomon SSD1362 display controller

description: |
    The Solomon SSD1362 is a grayscale OLED controller
    with 256x64 resolution and 16 gray levels.

compatible: "solomon,ssd1362"

include: [mipi-dbi-spi-device.yaml, display-controller.yaml]

properties:
  column-offset:
    type: int
    default: 0
    description: First visible column number.

  row-offset:
    type: int
    default: 0
    description: |
      COM pin used as first row, mapped to the line set by start-line.
      The default corresponds to the reset value of the register.

  start-line:
    type: int
    default: 0
    description: |
      Starting line address of display RAM (0-63).
      The default corresponds to the reset value of the register.

  mux-ratio:
    type: int
    default: 64
    description: COM Pin Multiplex ratio from 16 to 64. Typically height.

  oscillator-freq:
    type: int
    required: true
    description: |
      Front clock divider (3:0) / oscillator frequency (7:4).
      A good starting value for SSD1362 is 0xA0.

  precharge-voltage:
    type: int
    required: true
    description: |
      Set precharge voltage, from 0 (0.2 x VCC) to 0x1F (0.51 x VCC).
      A good starting value is 0x1F.

  vcomh-voltage:
    type: int
    required: true
    description: |
      Set COM deselect voltage, from 0 to 0x7 (0.86 x VCC).
      A good starting value is 0x07.

  phase-length:
    type: int
    required: true
    description: |
      Phase Length for segment charging (7:4) and discharging (3:0).
      A good starting value for SSD1362 is 0x22.

  second-precharge-period:
    type: int
    default: 4
    description: Second precharge period, from 0 (0 dclk) to 0xF (15 dclks).

  remap-row-first:
    type: boolean
    description: Set scan direction to vertical first (swap rows/columns).

  remap-columns:
    type: boolean
    description: Reverse the column order (flip horizontally).

  remap-rows:
    type: boolean
    description: Reverse the row order (flip vertically).

  remap-nibble:
    type: boolean
    description: Reverse nibble order within each byte.

  remap-com-odd-even-split:
    type: boolean
    description: Odd even split of COM pins.

  remap-com-dual:
    type: boolean
    description: SEG left/right remap.

  inversion-on:
    type: boolean
    description: Turn on display color inverting.

  iref-external:
    type: boolean
    description: Use external IREF current reference instead of internal.
```

## dts/bindings/flash_controller/wch,ch32v20x_30x-flash-controller.yaml
```yaml
# Copyright (c) 2026 The ZMK Contributors
# SPDX-License-Identifier: Apache-2.0

description: WCH CH32V20x/30x flash controller (FPEC)

compatible: "wch,ch32v20x_30x-flash-controller"

include: flash-controller.yaml
```

## dts/bindings/serial/wch,usart.yaml
```yaml
description: WCH CH32V00x UART

compatible: "wch,usart"

include: [uart-controller.yaml, pinctrl-device.yaml]

properties:
  reg:
    required: true

  single-wire:
    type: boolean
    description: |
      Enable single-wire half-duplex communication. TX and RX are connected
      internally and only the TX pin is used afterwards, so only it should be
      configured in pinctrl -- as an open-drain output, since the line is
      shared. RX/TX conflicts must be handled on the user side.
```

## dts/bindings/usb/wch,ch32x035-usbfs.yaml
```yaml
# Copyright (c) 2026 The ZMK Contributors
# SPDX-License-Identifier: Apache-2.0

description: |
  WCH CH32X035 USBFS device controller (lineage-A register block).

  Distinct from "wch,usbfs" (the V20x/V30x USBHD/USBOTG_FS controller): the
  X035 has a device-only register map at 0x40023400, no UEP4 DMA register, a
  packed UEPn_CTRL_H handshake word and its USB PHY analog controls live in
  AFIO->CTLR rather than the endpoint block. It therefore uses a dedicated
  driver (udc_wch_x03x.c) and this dedicated compatible.

  Two clocks are required and must be listed in order: the USBFS AHB gate
  first, then the AFIO gate (the driver writes AFIO->CTLR to enable the PHY).

compatible: "wch,ch32x035-usbfs"

include: usb-ep.yaml

properties:
  reg:
    required: true

  interrupts:
    required: true

  clocks:
    required: true
    description: |
      USBFS gate (AHB) as clocks[0], AFIO gate (APB2) as clocks[1].

  wch,vdd-5v:
    type: boolean
    description: |
      Set when the part runs from a 5V VDD. Selects the 10K D+ pull-up and
      disables the internal 3.3V PHY LDO. When unset (default, 3.3V VDD) the
      internal PHY LDO is enabled and a 1.5K D+ pull-up is used.
```

## soc/wch/ch32v/qingke_v4c/Kconfig.defconfig.ch32x035
```kconfig
# Copyright (c) 2026 The ZMK Contributors
# SPDX-License-Identifier: Apache-2.0

if SOC_CH32X035

config VECTOR_TABLE_SIZE
	default 60

config NUM_IRQS
	default 60

endif # SOC_CH32X035
```

## soc/wch/ch32v/qingke_v4c/Kconfig.soc.ch32x035
```kconfig
# Copyright (c) 2026 The ZMK Contributors
# SPDX-License-Identifier: Apache-2.0

config SOC_CH32X035
	bool
	select SOC_SERIES_QINGKE_V4C

config SOC
	default "ch32x035" if SOC_CH32X035
```

## tests/bsim/bluetooth/ll/conn/Kconfig
```kconfig
# Copyright (c) 2024 Nordic Semiconductor ASA
# SPDX-License-Identifier: Apache-2.0

config TEST_CONN_INTERVAL_1MS
	bool "Test 1 ms connection interval support"
	help
	  Test 1 ms connection interval support.

config TEST_CONN_INTERVAL_500US
	bool "Test 500 us connection interval support"
	help
	  Test 500 us connection interval support, i.e. the low-latency
	  connection interval value 0 (500 us steps below interval value 6).

menu "Zephyr Kernel"
source "Kconfig.zephyr"
endmenu
```
